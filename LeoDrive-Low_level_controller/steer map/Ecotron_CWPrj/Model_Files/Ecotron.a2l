/******************************************************************************
* ASAP2 file: Ecotron.a2l
* Academic License - for use in teaching, academic research, and meeting
* course requirements at degree granting institutions only. Not for
* government, commercial, or other organizational use.
* Code generation for model "Ecotron".
* Model version : 1.206
* Simulink Coder version : 9.2 (R2019b) 18-Jul-2019
* C source code generated on : Thu Jun 13 18:26:42 2024
* Target selection: EcoCoderTC27x.tlc
* Embedded hardware selection: Infineon->TriCore
* Code generation objectives: Unspecified
* Validation result: Not run
* (add additional file header information here)
******************************************************************************/ ASAP2_VERSION 1 31
/* Version 1.31 */
/begin PROJECT ProjectName "Project Comment Goes Here"
/begin HEADER "Header Comments go here" /end HEADER
/begin MODULE ModuleName "Module Comment Goes Here"
/* EcoCoder v2.9.12 R7 Target:EH2275A02 verCalTool:0.0*/
/* XCP-En:0 XCPCalTool:EcoCAL INCA CANape XCP-CAN:CAN_CTRL_C XCP-CAN-Baud:500000bps*/
/* CCP-En:1 CCP-TYPE:Configurable CCPCalTool:EcoCAL INCA CCP-CAN:CAN_CTRL_A CCP-CAN-Baud:500000bps*/
/*PGCANAEn:NoUse PGCANAStation:NoUse PGCANABaud:500kbps PGCANACRO:NoUse PGCANADTO:NoUse*/
/*PGCANBEn:NoUse PGCANBStation:NoUse PGCANBBaud:500kbps PGCANBCRO:NoUse PGCANBDTO:NoUse*/
/*PGCANCEn:NoUse PGCANCStation:NoUse PGCANCBaud:500kbps PGCANCCRO:NoUse PGCANCDTO:NoUse*/
/*PGCANDEn:NoUse PGCANDStation:NoUse PGCANDBaud:500kbps PGCANDCRO:NoUse PGCANDDTO:NoUse*/
/*ECO_XCP_Note_Start
/begin IF_DATA XCP
/begin PROTOCOL_LAYER
0x0100
0x07D0
0x2710
0x3E8
0x2710
0x3E8
0x19
0x19
0x08
0x08
BYTE_ORDER_MSB_LAST
ADDRESS_GRANULARITY_BYTE
OPTIONAL_CMD ALLOC_ODT_ENTRY
OPTIONAL_CMD ALLOC_ODT
OPTIONAL_CMD ALLOC_DAQ
OPTIONAL_CMD FREE_DAQ
OPTIONAL_CMD GET_DAQ_EVENT_INFO
OPTIONAL_CMD GET_DAQ_RESOLUTION_INFO
OPTIONAL_CMD GET_DAQ_PROCESSOR_INFO
OPTIONAL_CMD START_STOP_SYNCH
OPTIONAL_CMD START_STOP_DAQ_LIST
OPTIONAL_CMD GET_DAQ_LIST_MODE
OPTIONAL_CMD SET_DAQ_LIST_MODE
OPTIONAL_CMD WRITE_DAQ
OPTIONAL_CMD SET_DAQ_PTR
OPTIONAL_CMD CLEAR_DAQ_LIST
OPTIONAL_CMD DOWNLOAD
OPTIONAL_CMD SHORT_UPLOAD
OPTIONAL_CMD UPLOAD
OPTIONAL_CMD SET_MTA
OPTIONAL_CMD UNLOCK
OPTIONAL_CMD GET_SEED
OPTIONAL_CMD GET_ID
OPTIONAL_CMD GET_COMM_MODE_INFO
OPTIONAL_CMD BUILD_CHECKSUM
SEED_AND_KEY_EXTERNAL_FUNCTION ""
/end PROTOCOL_LAYER
/begin DAQ
DYNAMIC
0x00
0x05
0x00
OPTIMISATION_TYPE_DEFAULT
ADDRESS_EXTENSION_FREE
IDENTIFICATION_FIELD_TYPE_ABSOLUTE
GRANULARITY_ODT_ENTRY_SIZE_DAQ_BYTE
0x07
OVERLOAD_INDICATION_PID
/begin STIM
GRANULARITY_ODT_ENTRY_SIZE_STIM_BYTE
0x07
/end STIM
/begin EVENT
"5ms"
"5ms"
0x00
DAQ
0x01
0x05
0x06
0x00
/end EVENT
/begin EVENT
"20ms"
"20ms"
0x01
DAQ
0x01
0x02
0x07
0x00
/end EVENT
/begin EVENT
"50ms"
"50ms"
0x02
DAQ
0x01
0x05
0x07
0x00
/end EVENT
/begin EVENT
"100ms"
"100ms"
0x03
DAQ
0x01
0x01
0x08
0x00
/end EVENT
/begin EVENT
"200ms"
"200m"
0x04
DAQ
0x01
0x02
0x08
0x00
/end EVENT
/end DAQ
/begin PAG
0x00
/end PAG
/begin PGM
PGM_MODE_ABSOLUTE
0x00
0x00
/end PGM
/begin XCP_ON_CAN
0x0100
CAN_ID_MASTER 0x100
CAN_ID_SLAVE 0x101
BAUDRATE 500000
SAMPLE_POINT 0x4B
SAMPLE_RATE SINGLE
BTL_CYCLES 0x08
SJW 0x02
SYNC_EDGE SINGLE
/end XCP_ON_CAN
/end IF_DATA
/begin IF_DATA CANAPE_ADDRESS_UPDATE
/end IF_DATA
/begin MOD_PAR "_default_ModParComment"
/begin MEMORY_SEGMENT _ROMCAL
"calibration_rom"
DATA
FLASH
INTERN
0x80200000
0x8000
-1 -1 -1 -1 -1
/begin IF_DATA XCP
/begin SEGMENT
0x00
0x01
0x00
0x00
0x00
/begin CHECKSUM
XCP_CRC_16_CITT
MAX_BLOCK_SIZE 0xFFFF
EXTERNAL_FUNCTION "String.Empty"
/end CHECKSUM
/begin PAGE
0x00
ECU_ACCESS_DONT_CARE
XCP_READ_ACCESS_DONT_CARE
XCP_WRITE_ACCESS_DONT_CARE
INIT_SEGMENT 0x00
/end PAGE
/begin ADDRESS_MAPPING
0x80200000
0x70000000
0x8000
/end ADDRESS_MAPPING
/end SEGMENT
/end IF_DATA
/end MEMORY_SEGMENT
/begin MEMORY_SEGMENT _CODE
"ecu_code"
CODE
FLASH
INTERN
0x80010000
0x001EFFFF
-1 -1 -1 -1 -1
/end MEMORY_SEGMENT
/end MOD_PAR
ECO_XCP_Note_End*/
/*ECO_CCP_Note_Start*/
/begin MOD_PAR "_default_ModParComment" ADDR_EPK 0x80234000 EPK "EcoCoder v2.9.12 R7 2024-06-13 18:26:44"
 /begin MEMORY_SEGMENT _RAMCAL "calibration_ram" DATA RAM INTERN 0x70000000 0x8000 -1 -1 -1 -1 -1 /end MEMORY_SEGMENT
 /begin MEMORY_SEGMENT _ROMCAL "calibration_rom" DATA FLASH INTERN 0x80200000 0x8000 -1 -1 -1 -1 -1
  /begin IF_DATA ASAP1B_CCP ADDRESS_MAPPING 0x80200000 0x70000000 0x8000 /*EcoCoderCANapeStart
ADDR_MAPPING 0x80200000 0x70000000 0x8000
EcoCoderCANapeEnd*/ /end IF_DATA
 /end MEMORY_SEGMENT
 /begin MEMORY_SEGMENT _epk_data "epk_data" DATA FLASH INTERN 0x80234000 0xFF -1 -1 -1 -1 -1
  /begin IF_DATA ASAP1B_CCP ADDRESS_MAPPING 0x80234000 0x80234000 0xFF /*EcoCoderCANapeStart
ADDR_MAPPING 0x80234000 0x80234000 0xFF
EcoCoderCANapeEnd*/ /end IF_DATA
 /end MEMORY_SEGMENT
 /begin MEMORY_SEGMENT _CODE "ecu_code" CODE FLASH INTERN 0x80010000 0x001EFFFF -1 -1 -1 -1 -1 /end MEMORY_SEGMENT
/end MOD_PAR
/begin IF_DATA ASAP1B_CCP
 /begin SOURCE "20ms" 3 20 DISPLAY_IDENTIFIER DAQ2
  /begin QP_BLOB 1 LENGTH 0x20 CAN_ID_FIXED 0x101 RASTER 1 REDUCTION_ALLOWED FIRST_PID 0x3C /end QP_BLOB
 /end SOURCE
 /begin SOURCE "100ms" 3 100 DISPLAY_IDENTIFIER DAQ3
  /begin QP_BLOB 2 LENGTH 0x30 CAN_ID_FIXED 0x101 RASTER 2 REDUCTION_ALLOWED FIRST_PID 0x78 /end QP_BLOB
 /end SOURCE
 /begin RASTER "20ms" "20ms" 1 3 20 /end RASTER
 /begin RASTER "100ms" "100ms" 2 3 100 /end RASTER
 /begin SEED_KEY "" "" "" /end SEED_KEY
 /begin CHECKSUM "CRC16.dll" /end CHECKSUM
 /begin TP_BLOB 0x0201 0x0204 0x100 0x101 0x112 1 BAUDRATE 500000 SAMPLE_POINT 70 SAMPLE_RATE 1 BTL_CYCLES 10 SJW 1 SYNC_EDGE SINGLE DAQ_MODE 0 CONSISTENCY 1 ADDRESS_EXTENSION 0 RESUME_SUPPORTED STORE_SUPPORTED
  /begin CHECKSUM_PARAM 0x9001 /*EcoCoderCANapeStart
0x0C
EcoCoderCANapeEnd*/ 0xffffffff CHECKSUM_CALCULATION ACTIVE_PAGE /end CHECKSUM_PARAM
  /begin DEFINED_PAGES 0x00 "RAM_PAGE" 0x00 0x70000000 0x8000 RAM RAM_INIT_BY_ECU /end DEFINED_PAGES
  OPTIONAL_CMD 0X5 OPTIONAL_CMD 0X8 OPTIONAL_CMD 0X9 OPTIONAL_CMD 0XC OPTIONAL_CMD 0XD OPTIONAL_CMD 0XE OPTIONAL_CMD 0XF OPTIONAL_CMD 0X10 OPTIONAL_CMD 0X11 OPTIONAL_CMD 0X12 OPTIONAL_CMD 0X13 OPTIONAL_CMD 0X18 OPTIONAL_CMD 0X19 OPTIONAL_CMD 0X20 OPTIONAL_CMD 0X21 OPTIONAL_CMD 0X22 OPTIONAL_CMD 0X23 /end TP_BLOB
/end IF_DATA
/*ECO_CCP_Note_End*/
/begin MOD_COMMON "" /* Comment */ ALIGNMENT_BYTE 1 ALIGNMENT_WORD 1 ALIGNMENT_LONG 1 ALIGNMENT_FLOAT32_IEEE 1 ALIGNMENT_FLOAT64_IEEE 1 BYTE_ORDER MSB_LAST DEPOSIT ABSOLUTE /end MOD_COMMON
/begin RECORD_LAYOUT Scalar_BOOLEAN FNC_VALUES 1 UBYTE COLUMN_DIR DIRECT /end RECORD_LAYOUT
/begin RECORD_LAYOUT Scalar_UBYTE FNC_VALUES 1 UBYTE COLUMN_DIR DIRECT /end RECORD_LAYOUT
/begin RECORD_LAYOUT Scalar_BYTE FNC_VALUES 1 SBYTE COLUMN_DIR DIRECT /end RECORD_LAYOUT
/begin RECORD_LAYOUT Scalar_UWORD FNC_VALUES 1 UWORD COLUMN_DIR DIRECT /end RECORD_LAYOUT
/begin RECORD_LAYOUT Scalar_SWORD FNC_VALUES 1 SWORD COLUMN_DIR DIRECT /end RECORD_LAYOUT
/begin RECORD_LAYOUT Scalar_ULONG FNC_VALUES 1 ULONG COLUMN_DIR DIRECT /end RECORD_LAYOUT
/begin RECORD_LAYOUT Scalar_LONG FNC_VALUES 1 SLONG COLUMN_DIR DIRECT /end RECORD_LAYOUT
/begin RECORD_LAYOUT Scalar_FLOAT32_IEEE FNC_VALUES 1 FLOAT32_IEEE COLUMN_DIR DIRECT /end RECORD_LAYOUT
/begin RECORD_LAYOUT Scalar_FLOAT64_IEEE FNC_VALUES 1 FLOAT64_IEEE COLUMN_DIR DIRECT /end RECORD_LAYOUT
/begin RECORD_LAYOUT Lookup1D_BOOLEAN FNC_VALUES 1 UBYTE COLUMN_DIR DIRECT /end RECORD_LAYOUT
/begin RECORD_LAYOUT Lookup1D_X_BOOLEAN AXIS_PTS_X 1 UBYTE INDEX_INCR DIRECT /end RECORD_LAYOUT
/begin RECORD_LAYOUT Lookup1D_BYTE FNC_VALUES 1 SBYTE COLUMN_DIR DIRECT /end RECORD_LAYOUT
/begin RECORD_LAYOUT Lookup1D_X_BYTE AXIS_PTS_X 1 SBYTE INDEX_INCR DIRECT /end RECORD_LAYOUT
/begin RECORD_LAYOUT Lookup1D_UBYTE FNC_VALUES 1 UBYTE COLUMN_DIR DIRECT /end RECORD_LAYOUT
/begin RECORD_LAYOUT Lookup1D_X_UBYTE AXIS_PTS_X 1 UBYTE INDEX_INCR DIRECT /end RECORD_LAYOUT
/begin RECORD_LAYOUT Lookup1D_UWORD FNC_VALUES 1 UWORD COLUMN_DIR DIRECT /end RECORD_LAYOUT
/begin RECORD_LAYOUT Lookup1D_X_UWORD AXIS_PTS_X 1 UWORD INDEX_INCR DIRECT /end RECORD_LAYOUT
/begin RECORD_LAYOUT Lookup1D_WORD FNC_VALUES 1 SWORD COLUMN_DIR DIRECT /end RECORD_LAYOUT
/begin RECORD_LAYOUT Lookup1D_X_WORD AXIS_PTS_X 1 SWORD INDEX_INCR DIRECT /end RECORD_LAYOUT
/begin RECORD_LAYOUT Lookup1D_ULONG FNC_VALUES 1 ULONG COLUMN_DIR DIRECT /end RECORD_LAYOUT
/begin RECORD_LAYOUT Lookup1D_X_ULONG AXIS_PTS_X 1 ULONG INDEX_INCR DIRECT /end RECORD_LAYOUT
/begin RECORD_LAYOUT Lookup1D_SLONG FNC_VALUES 1 SLONG COLUMN_DIR DIRECT /end RECORD_LAYOUT
/begin RECORD_LAYOUT Lookup1D_X_LONG AXIS_PTS_X 1 SLONG INDEX_INCR DIRECT /end RECORD_LAYOUT
/begin RECORD_LAYOUT Lookup1D_FLOAT32_IEEE FNC_VALUES 1 FLOAT32_IEEE COLUMN_DIR DIRECT /end RECORD_LAYOUT
/begin RECORD_LAYOUT Lookup1D_X_FLOAT32_IEEE AXIS_PTS_X 1 FLOAT32_IEEE INDEX_INCR DIRECT /end RECORD_LAYOUT
/begin RECORD_LAYOUT Lookup1D_FLOAT64_IEEE FNC_VALUES 1 FLOAT64_IEEE COLUMN_DIR DIRECT /end RECORD_LAYOUT
/begin RECORD_LAYOUT Lookup1D_X_FLOAT64_IEEE AXIS_PTS_X 1 FLOAT64_IEEE INDEX_INCR DIRECT /end RECORD_LAYOUT
/begin RECORD_LAYOUT Lookup2D_BOOLEAN FNC_VALUES 1 UBYTE COLUMN_DIR DIRECT /end RECORD_LAYOUT
/begin RECORD_LAYOUT Lookup2D_X_BOOLEAN AXIS_PTS_X 1 UBYTE INDEX_INCR DIRECT /end RECORD_LAYOUT
/begin RECORD_LAYOUT Lookup2D_UBYTE FNC_VALUES 1 UBYTE COLUMN_DIR DIRECT /end RECORD_LAYOUT
/begin RECORD_LAYOUT Lookup2D_X_UBYTE AXIS_PTS_X 1 UBYTE INDEX_INCR DIRECT /end RECORD_LAYOUT
/begin RECORD_LAYOUT Lookup2D_BYTE FNC_VALUES 1 SBYTE COLUMN_DIR DIRECT /end RECORD_LAYOUT
/begin RECORD_LAYOUT Lookup2D_X_BYTE AXIS_PTS_X 1 SBYTE INDEX_INCR DIRECT /end RECORD_LAYOUT
/begin RECORD_LAYOUT Lookup2D_UWORD FNC_VALUES 1 UWORD COLUMN_DIR DIRECT /end RECORD_LAYOUT
/begin RECORD_LAYOUT Lookup2D_X_UWORD AXIS_PTS_X 1 UWORD INDEX_INCR DIRECT /end RECORD_LAYOUT
/begin RECORD_LAYOUT Lookup2D_WORD FNC_VALUES 1 SWORD COLUMN_DIR DIRECT /end RECORD_LAYOUT
/begin RECORD_LAYOUT Lookup2D_X_WORD AXIS_PTS_X 1 SWORD INDEX_INCR DIRECT /end RECORD_LAYOUT
/begin RECORD_LAYOUT Lookup2D_ULONG FNC_VALUES 1 ULONG COLUMN_DIR DIRECT /end RECORD_LAYOUT
/begin RECORD_LAYOUT Lookup2D_X_ULONG AXIS_PTS_X 1 ULONG INDEX_INCR DIRECT /end RECORD_LAYOUT
/begin RECORD_LAYOUT Lookup2D_LONG FNC_VALUES 1 SLONG COLUMN_DIR DIRECT /end RECORD_LAYOUT
/begin RECORD_LAYOUT Lookup2D_X_LONG AXIS_PTS_X 1 SLONG INDEX_INCR DIRECT /end RECORD_LAYOUT
/begin RECORD_LAYOUT Lookup2D_FLOAT32_IEEE FNC_VALUES 1 FLOAT32_IEEE COLUMN_DIR DIRECT /end RECORD_LAYOUT
/begin RECORD_LAYOUT Lookup2D_X_FLOAT32_IEEE AXIS_PTS_X 1 FLOAT32_IEEE INDEX_INCR DIRECT /end RECORD_LAYOUT
/begin RECORD_LAYOUT Lookup2D_FLOAT64_IEEE FNC_VALUES 1 FLOAT64_IEEE COLUMN_DIR DIRECT /end RECORD_LAYOUT
/begin RECORD_LAYOUT Lookup2D_X_FLOAT64_IEEE AXIS_PTS_X 1 FLOAT64_IEEE INDEX_INCR DIRECT /end RECORD_LAYOUT
/begin CHARACTERISTIC Activate_ThrottleControllerOvrCal_val "" VALUE 0x0000 /* @ECU_Address@Activate_ThrottleControllerOvrCal_val@ */ Scalar_FLOAT32_IEEE 0 Ecotron_CM_single -3.4E+38 3.4E+38 /end CHARACTERISTIC
/begin CHARACTERISTIC Brake_CalibCMDOvrCal_val "" VALUE 0x0000 /* @ECU_Address@Brake_CalibCMDOvrCal_val@ */ Scalar_FLOAT32_IEEE 0 Ecotron_CM_single -3.4E+38 3.4E+38 /end CHARACTERISTIC
/begin CHARACTERISTIC Brake_ControlMode "" VALUE 0x0000 /* @ECU_Address@Brake_ControlMode@ */ Scalar_FLOAT32_IEEE 0 Ecotron_CM_single -3.4E+38 3.4E+38 /end CHARACTERISTIC
/begin CHARACTERISTIC Brake_PID_D "" VALUE 0x0000 /* @ECU_Address@Brake_PID_D@ */ Scalar_FLOAT32_IEEE 0 Ecotron_CM_single -3.4E+38 3.4E+38 /end CHARACTERISTIC
/begin CHARACTERISTIC Brake_PID_I "" VALUE 0x0000 /* @ECU_Address@Brake_PID_I@ */ Scalar_FLOAT32_IEEE 0 Ecotron_CM_single -3.4E+38 3.4E+38 /end CHARACTERISTIC
/begin CHARACTERISTIC Brake_PID_P "" VALUE 0x0000 /* @ECU_Address@Brake_PID_P@ */ Scalar_FLOAT32_IEEE 0 Ecotron_CM_single -3.4E+38 3.4E+38 /end CHARACTERISTIC
/begin CHARACTERISTIC Buzz_falling_duration "" VALUE 0x0000 /* @ECU_Address@Buzz_falling_duration@ */ Scalar_FLOAT32_IEEE 0 Ecotron_CM_single -3.4E+38 3.4E+38 /end CHARACTERISTIC
/begin CHARACTERISTIC Buzz_falling_offduration "" VALUE 0x0000 /* @ECU_Address@Buzz_falling_offduration@ */ Scalar_FLOAT32_IEEE 0 Ecotron_CM_single -3.4E+38 3.4E+38 /end CHARACTERISTIC
/begin CHARACTERISTIC Buzz_rising_duration "" VALUE 0x0000 /* @ECU_Address@Buzz_rising_duration@ */ Scalar_FLOAT32_IEEE 0 Ecotron_CM_single -3.4E+38 3.4E+38 /end CHARACTERISTIC
/begin CHARACTERISTIC CANA_recover "" VALUE 0x0000 /* @ECU_Address@CANA_recover@ */ Scalar_FLOAT32_IEEE 0 Ecotron_CM_single -3.4E+38 3.4E+38 /end CHARACTERISTIC
/begin CHARACTERISTIC CANB_recover "" VALUE 0x0000 /* @ECU_Address@CANB_recover@ */ Scalar_FLOAT32_IEEE 0 Ecotron_CM_single -3.4E+38 3.4E+38 /end CHARACTERISTIC
/begin CHARACTERISTIC CANC_recover "" VALUE 0x0000 /* @ECU_Address@CANC_recover@ */ Scalar_FLOAT32_IEEE 0 Ecotron_CM_single -3.4E+38 3.4E+38 /end CHARACTERISTIC
/begin CHARACTERISTIC Compensation_I "" VALUE 0x0000 /* @ECU_Address@Compensation_I@ */ Scalar_FLOAT32_IEEE 0 Ecotron_CM_single -3.4E+38 3.4E+38 /end CHARACTERISTIC
/begin CHARACTERISTIC Compensation_P "" VALUE 0x0000 /* @ECU_Address@Compensation_P@ */ Scalar_FLOAT32_IEEE 0 Ecotron_CM_single -3.4E+38 3.4E+38 /end CHARACTERISTIC
/begin CHARACTERISTIC Delay "" VALUE 0x0000 /* @ECU_Address@Delay@ */ Scalar_FLOAT32_IEEE 0 Ecotron_CM_single -3.4E+38 3.4E+38 /end CHARACTERISTIC
/begin CHARACTERISTIC EPAS_MaxSpeed "" VALUE 0x0000 /* @ECU_Address@EPAS_MaxSpeed@ */ Scalar_FLOAT32_IEEE 0 Ecotron_CM_single -3.4E+38 3.4E+38 /end CHARACTERISTIC
/begin CHARACTERISTIC SetACCOvrCal_val "" VALUE 0x0000 /* @ECU_Address@SetACCOvrCal_val@ */ Scalar_FLOAT32_IEEE 0 Ecotron_CM_single -3.4E+38 3.4E+38 /end CHARACTERISTIC
/begin CHARACTERISTIC Set_Brake_PosOvrCal_val "" VALUE 0x0000 /* @ECU_Address@Set_Brake_PosOvrCal_val@ */ Scalar_FLOAT32_IEEE 0 Ecotron_CM_single -3.4E+38 3.4E+38 /end CHARACTERISTIC
/begin CHARACTERISTIC Set_GasOvrCal_val "" VALUE 0x0000 /* @ECU_Address@Set_GasOvrCal_val@ */ Scalar_FLOAT32_IEEE 0 Ecotron_CM_single -3.4E+38 3.4E+38 /end CHARACTERISTIC
/begin CHARACTERISTIC Set_GearEnableOvrCal_val "" VALUE 0x0000 /* @ECU_Address@Set_GearEnableOvrCal_val@ */ Scalar_FLOAT32_IEEE 0 Ecotron_CM_single -3.4E+38 3.4E+38 /end CHARACTERISTIC
/begin CHARACTERISTIC SteeringWheelRateOvrCal_val "" VALUE 0x0000 /* @ECU_Address@SteeringWheelRateOvrCal_val@ */ Scalar_FLOAT32_IEEE 0 Ecotron_CM_single -3.4E+38 3.4E+38 /end CHARACTERISTIC
/begin CHARACTERISTIC Steering_ControlModeOvrCal_val "" VALUE 0x0000 /* @ECU_Address@Steering_ControlModeOvrCal_val@ */ Scalar_FLOAT32_IEEE 0 Ecotron_CM_single -3.4E+38 3.4E+38 /end CHARACTERISTIC
/begin CHARACTERISTIC Steering_ResetCommandOvrCal_val "" VALUE 0x0000 /* @ECU_Address@Steering_ResetCommandOvrCal_val@ */ Scalar_FLOAT32_IEEE 0 Ecotron_CM_single -3.4E+38 3.4E+38 /end CHARACTERISTIC
/begin CHARACTERISTIC Steering_Set_PosOvrCal_val "" VALUE 0x0000 /* @ECU_Address@Steering_Set_PosOvrCal_val@ */ Scalar_FLOAT32_IEEE 0 Ecotron_CM_single -3.4E+38 3.4E+38 /end CHARACTERISTIC
/begin CHARACTERISTIC Torque_PID_D "" VALUE 0x0000 /* @ECU_Address@Torque_PID_D@ */ Scalar_FLOAT32_IEEE 0 Ecotron_CM_single -3.4E+38 3.4E+38 /end CHARACTERISTIC
/begin CHARACTERISTIC Torque_PID_I "" VALUE 0x0000 /* @ECU_Address@Torque_PID_I@ */ Scalar_FLOAT32_IEEE 0 Ecotron_CM_single -3.4E+38 3.4E+38 /end CHARACTERISTIC
/begin CHARACTERISTIC Torque_PID_P "" VALUE 0x0000 /* @ECU_Address@Torque_PID_P@ */ Scalar_FLOAT32_IEEE 0 Ecotron_CM_single -3.4E+38 3.4E+38 /end CHARACTERISTIC
/begin CHARACTERISTIC interval "" VALUE 0x0000 /* @ECU_Address@interval@ */ Scalar_FLOAT32_IEEE 0 Ecotron_CM_single -3.4E+38 3.4E+38 /end CHARACTERISTIC
/begin CHARACTERISTIC interval2 "" VALUE 0x0000 /* @ECU_Address@interval2@ */ Scalar_FLOAT32_IEEE 0 Ecotron_CM_single -3.4E+38 3.4E+38 /end CHARACTERISTIC
/begin CHARACTERISTIC repeat "" VALUE 0x0000 /* @ECU_Address@repeat@ */ Scalar_FLOAT32_IEEE 0 Ecotron_CM_single -3.4E+38 3.4E+38 /end CHARACTERISTIC
/begin CHARACTERISTIC Activate_ThrottleControllerOvrEn_val "Override Control" VALUE 0x0000 /* @ECU_Address@Activate_ThrottleControllerOvrEn_val@ */ Scalar_BOOLEAN 0 Ecotron_CM_boolean 0 1 /end CHARACTERISTIC
/begin CHARACTERISTIC Brake_CalibCMDOvrEn_val "Override Control" VALUE 0x0000 /* @ECU_Address@Brake_CalibCMDOvrEn_val@ */ Scalar_BOOLEAN 0 Ecotron_CM_boolean 0 1 /end CHARACTERISTIC
/begin CHARACTERISTIC Brake_ResetOvrEn_val "Override Control" VALUE 0x0000 /* @ECU_Address@Brake_ResetOvrEn_val@ */ Scalar_BOOLEAN 0 Ecotron_CM_boolean 0 1 /end CHARACTERISTIC
/begin CHARACTERISTIC Button_Hazard_LightOvrCal_val "" VALUE 0x0000 /* @ECU_Address@Button_Hazard_LightOvrCal_val@ */ Scalar_BOOLEAN 0 Ecotron_CM_boolean 0 1 /end CHARACTERISTIC
/begin CHARACTERISTIC Button_Hazard_LightOvrEn_val "Override Control" VALUE 0x0000 /* @ECU_Address@Button_Hazard_LightOvrEn_val@ */ Scalar_BOOLEAN 0 Ecotron_CM_boolean 0 1 /end CHARACTERISTIC
/begin CHARACTERISTIC Button_Headlight_FlasherOvrCal_val "" VALUE 0x0000 /* @ECU_Address@Button_Headlight_FlasherOvrCal_val@ */ Scalar_BOOLEAN 0 Ecotron_CM_boolean 0 1 /end CHARACTERISTIC
/begin CHARACTERISTIC Button_Headlight_FlasherOvrEn_val "Override Control" VALUE 0x0000 /* @ECU_Address@Button_Headlight_FlasherOvrEn_val@ */ Scalar_BOOLEAN 0 Ecotron_CM_boolean 0 1 /end CHARACTERISTIC
/begin CHARACTERISTIC Button_HighBeamOvrCal_val "" VALUE 0x0000 /* @ECU_Address@Button_HighBeamOvrCal_val@ */ Scalar_BOOLEAN 0 Ecotron_CM_boolean 0 1 /end CHARACTERISTIC
/begin CHARACTERISTIC Button_HighBeamOvrEn_val "Override Control" VALUE 0x0000 /* @ECU_Address@Button_HighBeamOvrEn_val@ */ Scalar_BOOLEAN 0 Ecotron_CM_boolean 0 1 /end CHARACTERISTIC
/begin CHARACTERISTIC Button_Left_BlinkerOvrCal_val "" VALUE 0x0000 /* @ECU_Address@Button_Left_BlinkerOvrCal_val@ */ Scalar_BOOLEAN 0 Ecotron_CM_boolean 0 1 /end CHARACTERISTIC
/begin CHARACTERISTIC Button_Left_BlinkerOvrEn_val "Override Control" VALUE 0x0000 /* @ECU_Address@Button_Left_BlinkerOvrEn_val@ */ Scalar_BOOLEAN 0 Ecotron_CM_boolean 0 1 /end CHARACTERISTIC
/begin CHARACTERISTIC Button_Right_BlinkerOvrCal_val "" VALUE 0x0000 /* @ECU_Address@Button_Right_BlinkerOvrCal_val@ */ Scalar_BOOLEAN 0 Ecotron_CM_boolean 0 1 /end CHARACTERISTIC
/begin CHARACTERISTIC Button_Right_BlinkerOvrEn_val "Override Control" VALUE 0x0000 /* @ECU_Address@Button_Right_BlinkerOvrEn_val@ */ Scalar_BOOLEAN 0 Ecotron_CM_boolean 0 1 /end CHARACTERISTIC
/begin CHARACTERISTIC Buzz_controlOvrCal_val "" VALUE 0x0000 /* @ECU_Address@Buzz_controlOvrCal_val@ */ Scalar_BOOLEAN 0 Ecotron_CM_boolean 0 1 /end CHARACTERISTIC
/begin CHARACTERISTIC Buzz_controlOvrEn_val "Override Control" VALUE 0x0000 /* @ECU_Address@Buzz_controlOvrEn_val@ */ Scalar_BOOLEAN 0 Ecotron_CM_boolean 0 1 /end CHARACTERISTIC
/begin CHARACTERISTIC EPAS_DriverIntervention_overrideOvrCal_val "" VALUE 0x0000 /* @ECU_Address@EPAS_DriverIntervention_overrideOvrCal_val@ */ Scalar_BOOLEAN 0 Ecotron_CM_boolean 0 1 /end CHARACTERISTIC
/begin CHARACTERISTIC EPAS_DriverIntervention_overrideOvrEn_val "Override Control" VALUE 0x0000 /* @ECU_Address@EPAS_DriverIntervention_overrideOvrEn_val@ */ Scalar_BOOLEAN 0 Ecotron_CM_boolean 0 1 /end CHARACTERISTIC
/begin CHARACTERISTIC SetACCOvrEn_val "Override Control" VALUE 0x0000 /* @ECU_Address@SetACCOvrEn_val@ */ Scalar_BOOLEAN 0 Ecotron_CM_boolean 0 1 /end CHARACTERISTIC
/begin CHARACTERISTIC Set_Brake_PosOvrEn_val "Override Control" VALUE 0x0000 /* @ECU_Address@Set_Brake_PosOvrEn_val@ */ Scalar_BOOLEAN 0 Ecotron_CM_boolean 0 1 /end CHARACTERISTIC
/begin CHARACTERISTIC Set_GasOvrEn_val "Override Control" VALUE 0x0000 /* @ECU_Address@Set_GasOvrEn_val@ */ Scalar_BOOLEAN 0 Ecotron_CM_boolean 0 1 /end CHARACTERISTIC
/begin CHARACTERISTIC Set_GearEnableOvrEn_val "Override Control" VALUE 0x0000 /* @ECU_Address@Set_GearEnableOvrEn_val@ */ Scalar_BOOLEAN 0 Ecotron_CM_boolean 0 1 /end CHARACTERISTIC
/begin CHARACTERISTIC Set_GearOvrEn_val "Override Control" VALUE 0x0000 /* @ECU_Address@Set_GearOvrEn_val@ */ Scalar_BOOLEAN 0 Ecotron_CM_boolean 0 1 /end CHARACTERISTIC
/begin CHARACTERISTIC SteeringWheelRateOvrEn_val "Override Control" VALUE 0x0000 /* @ECU_Address@SteeringWheelRateOvrEn_val@ */ Scalar_BOOLEAN 0 Ecotron_CM_boolean 0 1 /end CHARACTERISTIC
/begin CHARACTERISTIC Steering_ControlModeOvrEn_val "Override Control" VALUE 0x0000 /* @ECU_Address@Steering_ControlModeOvrEn_val@ */ Scalar_BOOLEAN 0 Ecotron_CM_boolean 0 1 /end CHARACTERISTIC
/begin CHARACTERISTIC Steering_ResetCommandOvrEn_val "Override Control" VALUE 0x0000 /* @ECU_Address@Steering_ResetCommandOvrEn_val@ */ Scalar_BOOLEAN 0 Ecotron_CM_boolean 0 1 /end CHARACTERISTIC
/begin CHARACTERISTIC Steering_Set_PosOvrEn_val "Override Control" VALUE 0x0000 /* @ECU_Address@Steering_Set_PosOvrEn_val@ */ Scalar_BOOLEAN 0 Ecotron_CM_boolean 0 1 /end CHARACTERISTIC
/begin CHARACTERISTIC debug_PCheardbeatOvrCal_val "" VALUE 0x0000 /* @ECU_Address@debug_PCheardbeatOvrCal_val@ */ Scalar_BOOLEAN 0 Ecotron_CM_boolean 0 1 /end CHARACTERISTIC
/begin CHARACTERISTIC debug_PCheardbeatOvrEn_val "Override Control" VALUE 0x0000 /* @ECU_Address@debug_PCheardbeatOvrEn_val@ */ Scalar_BOOLEAN 0 Ecotron_CM_boolean 0 1 /end CHARACTERISTIC
/begin CHARACTERISTIC debug_otonomDisableOvrCal_val "" VALUE 0x0000 /* @ECU_Address@debug_otonomDisableOvrCal_val@ */ Scalar_BOOLEAN 0 Ecotron_CM_boolean 0 1 /end CHARACTERISTIC
/begin CHARACTERISTIC debug_otonomDisableOvrEn_val "Override Control" VALUE 0x0000 /* @ECU_Address@debug_otonomDisableOvrEn_val@ */ Scalar_BOOLEAN 0 Ecotron_CM_boolean 0 1 /end CHARACTERISTIC
/begin CHARACTERISTIC debug_otonomEnableOvrCal_val "" VALUE 0x0000 /* @ECU_Address@debug_otonomEnableOvrCal_val@ */ Scalar_BOOLEAN 0 Ecotron_CM_boolean 0 1 /end CHARACTERISTIC
/begin CHARACTERISTIC debug_otonomEnableOvrEn_val "Override Control" VALUE 0x0000 /* @ECU_Address@debug_otonomEnableOvrEn_val@ */ Scalar_BOOLEAN 0 Ecotron_CM_boolean 0 1 /end CHARACTERISTIC
/begin CHARACTERISTIC Brake_ResetOvrCal_val "" VALUE 0x0000 /* @ECU_Address@Brake_ResetOvrCal_val@ */ Scalar_UBYTE 0 Ecotron_CM_uint8 0 255 /end CHARACTERISTIC
/begin CHARACTERISTIC Brake_SetDuty "" VALUE 0x0000 /* @ECU_Address@Brake_SetDuty@ */ Scalar_UBYTE 0 Ecotron_CM_uint8 0 255 /end CHARACTERISTIC
/begin CHARACTERISTIC Set_GearOvrCal_val "" VALUE 0x0000 /* @ECU_Address@Set_GearOvrCal_val@ */ Scalar_UBYTE 0 Ecotron_CM_uint8 0 255 /end CHARACTERISTIC
/begin MEASUREMENT PC_FrontwheelMsg_cnt "" ULONG Ecotron_CM_uint32 0 0 0 4294967295 ECU_ADDRESS 0x0000 /* @ECU_Address@PC_FrontwheelMsg_cnt@ */ /end MEASUREMENT
/begin MEASUREMENT GOLF_rxVehiclemass "" ULONG Ecotron_CM_uint32 0 0 0 4294967295 ECU_ADDRESS 0x0000 /* @ECU_Address@GOLF_rxVehiclemass@ */ /end MEASUREMENT
/begin MEASUREMENT PC_SetLongAcc "" FLOAT32_IEEE Ecotron_CM_single 0 0 -3.4E+38 3.4E+38 ECU_ADDRESS 0x0000 /* @ECU_Address@PC_SetLongAcc@ */ /end MEASUREMENT
/begin MEASUREMENT PC_SetLimitVel "" FLOAT32_IEEE Ecotron_CM_single 0 0 -3.4E+38 3.4E+38 ECU_ADDRESS 0x0000 /* @ECU_Address@PC_SetLimitVel@ */ /end MEASUREMENT
/begin MEASUREMENT SetACCOvrMsr "" FLOAT32_IEEE Ecotron_CM_single 0 0 -3.4E+38 3.4E+38 ECU_ADDRESS 0x0000 /* @ECU_Address@SetACCOvrMsr@ */ /end MEASUREMENT
/begin MEASUREMENT GOLF_MotorRPM "" FLOAT32_IEEE Ecotron_CM_single 0 0 -3.4E+38 3.4E+38 ECU_ADDRESS 0x0000 /* @ECU_Address@GOLF_MotorRPM@ */ /end MEASUREMENT
/begin MEASUREMENT GOLF_KL75 "" FLOAT32_IEEE Ecotron_CM_single 0 0 -3.4E+38 3.4E+38 ECU_ADDRESS 0x0000 /* @ECU_Address@GOLF_KL75@ */ /end MEASUREMENT
/begin MEASUREMENT PDS_BoardTemp "" FLOAT32_IEEE Ecotron_CM_single 0 0 -3.4E+38 3.4E+38 ECU_ADDRESS 0x0000 /* @ECU_Address@PDS_BoardTemp@ */ /end MEASUREMENT
/begin MEASUREMENT PDS_InputVoltage "" FLOAT32_IEEE Ecotron_CM_single 0 0 -3.4E+38 3.4E+38 ECU_ADDRESS 0x0000 /* @ECU_Address@PDS_InputVoltage@ */ /end MEASUREMENT
/begin MEASUREMENT PDS_InputCurrent "" FLOAT32_IEEE Ecotron_CM_single 0 0 -3.4E+38 3.4E+38 ECU_ADDRESS 0x0000 /* @ECU_Address@PDS_InputCurrent@ */ /end MEASUREMENT
/begin MEASUREMENT THROTTLE_CurrentPedalPos "" FLOAT32_IEEE Ecotron_CM_single 0 0 -3.4E+38 3.4E+38 ECU_ADDRESS 0x0000 /* @ECU_Address@THROTTLE_CurrentPedalPos@ */ /end MEASUREMENT
/begin MEASUREMENT THROTTLE_ECUTimeout "" FLOAT32_IEEE Ecotron_CM_single 0 0 -3.4E+38 3.4E+38 ECU_ADDRESS 0x0000 /* @ECU_Address@THROTTLE_ECUTimeout@ */ /end MEASUREMENT
/begin MEASUREMENT THROTTLE_PedalConnectionError "" FLOAT32_IEEE Ecotron_CM_single 0 0 -3.4E+38 3.4E+38 ECU_ADDRESS 0x0000 /* @ECU_Address@THROTTLE_PedalConnectionError@ */ /end MEASUREMENT
/begin MEASUREMENT BBW_ReferenceBrakePos "" FLOAT32_IEEE Ecotron_CM_single 0 0 -3.4E+38 3.4E+38 ECU_ADDRESS 0x0000 /* @ECU_Address@BBW_ReferenceBrakePos@ */ /end MEASUREMENT
/begin MEASUREMENT BBW_BrakePos "" FLOAT32_IEEE Ecotron_CM_single 0 0 -3.4E+38 3.4E+38 ECU_ADDRESS 0x0000 /* @ECU_Address@BBW_BrakePos@ */ /end MEASUREMENT
/begin MEASUREMENT BBW_MotorDuty "" FLOAT32_IEEE Ecotron_CM_single 0 0 -3.4E+38 3.4E+38 ECU_ADDRESS 0x0000 /* @ECU_Address@BBW_MotorDuty@ */ /end MEASUREMENT
/begin MEASUREMENT BBW_MotorCurrent "" FLOAT32_IEEE Ecotron_CM_single 0 0 -3.4E+38 3.4E+38 ECU_ADDRESS 0x0000 /* @ECU_Address@BBW_MotorCurrent@ */ /end MEASUREMENT
/begin MEASUREMENT BBW_MotorVoltage "" FLOAT32_IEEE Ecotron_CM_single 0 0 -3.4E+38 3.4E+38 ECU_ADDRESS 0x0000 /* @ECU_Address@BBW_MotorVoltage@ */ /end MEASUREMENT
/begin MEASUREMENT BBW_BoxTemp "" FLOAT32_IEEE Ecotron_CM_single 0 0 -3.4E+38 3.4E+38 ECU_ADDRESS 0x0000 /* @ECU_Address@BBW_BoxTemp@ */ /end MEASUREMENT
/begin MEASUREMENT BBW_RawTorqueA "" FLOAT32_IEEE Ecotron_CM_single 0 0 -3.4E+38 3.4E+38 ECU_ADDRESS 0x0000 /* @ECU_Address@BBW_RawTorqueA@ */ /end MEASUREMENT
/begin MEASUREMENT BBW_RawTorqueB "" FLOAT32_IEEE Ecotron_CM_single 0 0 -3.4E+38 3.4E+38 ECU_ADDRESS 0x0000 /* @ECU_Address@BBW_RawTorqueB@ */ /end MEASUREMENT
/begin MEASUREMENT EPAS_RefSteerPos "" FLOAT32_IEEE Ecotron_CM_single 0 0 -3.4E+38 3.4E+38 ECU_ADDRESS 0x0000 /* @ECU_Address@EPAS_RefSteerPos@ */ /end MEASUREMENT
/begin MEASUREMENT EPAS_ActualSteeringPos "" FLOAT32_IEEE Ecotron_CM_single 0 0 -3.4E+38 3.4E+38 ECU_ADDRESS 0x0000 /* @ECU_Address@EPAS_ActualSteeringPos@ */ /end MEASUREMENT
/begin MEASUREMENT EPAS_MotorDuty "" FLOAT32_IEEE Ecotron_CM_single 0 0 -3.4E+38 3.4E+38 ECU_ADDRESS 0x0000 /* @ECU_Address@EPAS_MotorDuty@ */ /end MEASUREMENT
/begin MEASUREMENT EPAS_MotorCurrent "" FLOAT32_IEEE Ecotron_CM_single 0 0 -3.4E+38 3.4E+38 ECU_ADDRESS 0x0000 /* @ECU_Address@EPAS_MotorCurrent@ */ /end MEASUREMENT
/begin MEASUREMENT EPAS_MotorVoltage "" FLOAT32_IEEE Ecotron_CM_single 0 0 -3.4E+38 3.4E+38 ECU_ADDRESS 0x0000 /* @ECU_Address@EPAS_MotorVoltage@ */ /end MEASUREMENT
/begin MEASUREMENT EPAS_BoxTemp "" FLOAT32_IEEE Ecotron_CM_single 0 0 -3.4E+38 3.4E+38 ECU_ADDRESS 0x0000 /* @ECU_Address@EPAS_BoxTemp@ */ /end MEASUREMENT
/begin MEASUREMENT EPAS_TorqueA "" FLOAT32_IEEE Ecotron_CM_single 0 0 -3.4E+38 3.4E+38 ECU_ADDRESS 0x0000 /* @ECU_Address@EPAS_TorqueA@ */ /end MEASUREMENT
/begin MEASUREMENT EPAS_TorqueB "" FLOAT32_IEEE Ecotron_CM_single 0 0 -3.4E+38 3.4E+38 ECU_ADDRESS 0x0000 /* @ECU_Address@EPAS_TorqueB@ */ /end MEASUREMENT
/begin MEASUREMENT PC_SetFrontWheelAngle "" FLOAT32_IEEE Ecotron_CM_single 0 0 -3.4E+38 3.4E+38 ECU_ADDRESS 0x0000 /* @ECU_Address@PC_SetFrontWheelAngle@ */ /end MEASUREMENT
/begin MEASUREMENT PC_SetFrontWheelAngel_Rate "" FLOAT32_IEEE Ecotron_CM_single 0 0 -3.4E+38 3.4E+38 ECU_ADDRESS 0x0000 /* @ECU_Address@PC_SetFrontWheelAngel_Rate@ */ /end MEASUREMENT
/begin MEASUREMENT PC_SetGasPos "" FLOAT32_IEEE Ecotron_CM_single 0 0 -3.4E+38 3.4E+38 ECU_ADDRESS 0x0000 /* @ECU_Address@PC_SetGasPos@ */ /end MEASUREMENT
/begin MEASUREMENT PC_SetBrakePos "" FLOAT32_IEEE Ecotron_CM_single 0 0 -3.4E+38 3.4E+38 ECU_ADDRESS 0x0000 /* @ECU_Address@PC_SetBrakePos@ */ /end MEASUREMENT
/begin MEASUREMENT GOLF_LongitudinalAcceleration "" FLOAT32_IEEE Ecotron_CM_single 0 0 -3.4E+38 3.4E+38 ECU_ADDRESS 0x0000 /* @ECU_Address@GOLF_LongitudinalAcceleration@ */ /end MEASUREMENT
/begin MEASUREMENT GOLF_HandBrakeStatus "" FLOAT32_IEEE Ecotron_CM_single 0 0 -3.4E+38 3.4E+38 ECU_ADDRESS 0x0000 /* @ECU_Address@GOLF_HandBrakeStatus@ */ /end MEASUREMENT
/begin MEASUREMENT GOLF_BLWheelSpeed "" FLOAT32_IEEE Ecotron_CM_single 0 0 -3.4E+38 3.4E+38 ECU_ADDRESS 0x0000 /* @ECU_Address@GOLF_BLWheelSpeed@ */ /end MEASUREMENT
/begin MEASUREMENT GOLF_BRWheelSpeed "" FLOAT32_IEEE Ecotron_CM_single 0 0 -3.4E+38 3.4E+38 ECU_ADDRESS 0x0000 /* @ECU_Address@GOLF_BRWheelSpeed@ */ /end MEASUREMENT
/begin MEASUREMENT GOLF_FLWheelSpeed "" FLOAT32_IEEE Ecotron_CM_single 0 0 -3.4E+38 3.4E+38 ECU_ADDRESS 0x0000 /* @ECU_Address@GOLF_FLWheelSpeed@ */ /end MEASUREMENT
/begin MEASUREMENT GOLF_FRWheelSpeed "" FLOAT32_IEEE Ecotron_CM_single 0 0 -3.4E+38 3.4E+38 ECU_ADDRESS 0x0000 /* @ECU_Address@GOLF_FRWheelSpeed@ */ /end MEASUREMENT
/begin MEASUREMENT debug_CompensationPID_out "" FLOAT32_IEEE Ecotron_CM_single 0 0 -3.4E+38 3.4E+38 ECU_ADDRESS 0x0000 /* @ECU_Address@debug_CompensationPID_out@ */ /end MEASUREMENT
/begin MEASUREMENT GOLF_rxPitch "" FLOAT32_IEEE Ecotron_CM_single 0 0 -3.4E+38 3.4E+38 ECU_ADDRESS 0x0000 /* @ECU_Address@GOLF_rxPitch@ */ /end MEASUREMENT
/begin MEASUREMENT GOLF_MotorTorque_raw "" FLOAT32_IEEE Ecotron_CM_single 0 0 -3.4E+38 3.4E+38 ECU_ADDRESS 0x0000 /* @ECU_Address@GOLF_MotorTorque_raw@ */ /end MEASUREMENT
/begin MEASUREMENT GOLF_MotorTorque_filtered "" FLOAT32_IEEE Ecotron_CM_single 0 0 -3.4E+38 3.4E+38 ECU_ADDRESS 0x0000 /* @ECU_Address@GOLF_MotorTorque_filtered@ */ /end MEASUREMENT
/begin MEASUREMENT debug_Fr_request "" FLOAT32_IEEE Ecotron_CM_single 0 0 -3.4E+38 3.4E+38 ECU_ADDRESS 0x0000 /* @ECU_Address@debug_Fr_request@ */ /end MEASUREMENT
/begin MEASUREMENT debug_set_brake "" FLOAT32_IEEE Ecotron_CM_single 0 0 -3.4E+38 3.4E+38 ECU_ADDRESS 0x0000 /* @ECU_Address@debug_set_brake@ */ /end MEASUREMENT
/begin MEASUREMENT Set_Brake_PosOvrMsr "" FLOAT32_IEEE Ecotron_CM_single 0 0 -3.4E+38 3.4E+38 ECU_ADDRESS 0x0000 /* @ECU_Address@Set_Brake_PosOvrMsr@ */ /end MEASUREMENT
/begin MEASUREMENT GOLF_BrakePedalPos "" FLOAT32_IEEE Ecotron_CM_single 0 0 -3.4E+38 3.4E+38 ECU_ADDRESS 0x0000 /* @ECU_Address@GOLF_BrakePedalPos@ */ /end MEASUREMENT
/begin MEASUREMENT Brake_CalibCMDOvrMsr "" FLOAT32_IEEE Ecotron_CM_single 0 0 -3.4E+38 3.4E+38 ECU_ADDRESS 0x0000 /* @ECU_Address@Brake_CalibCMDOvrMsr@ */ /end MEASUREMENT
/begin MEASUREMENT Set_GasOvrMsr "" FLOAT32_IEEE Ecotron_CM_single 0 0 -3.4E+38 3.4E+38 ECU_ADDRESS 0x0000 /* @ECU_Address@Set_GasOvrMsr@ */ /end MEASUREMENT
/begin MEASUREMENT Activate_ThrottleControllerOvrMsr "" FLOAT32_IEEE Ecotron_CM_single 0 0 -3.4E+38 3.4E+38 ECU_ADDRESS 0x0000 /* @ECU_Address@Activate_ThrottleControllerOvrMsr@ */ /end MEASUREMENT
/begin MEASUREMENT Set_GearEnableOvrMsr "" FLOAT32_IEEE Ecotron_CM_single 0 0 -3.4E+38 3.4E+38 ECU_ADDRESS 0x0000 /* @ECU_Address@Set_GearEnableOvrMsr@ */ /end MEASUREMENT
/begin MEASUREMENT GOLF_HighBeam "" FLOAT32_IEEE Ecotron_CM_single 0 0 -3.4E+38 3.4E+38 ECU_ADDRESS 0x0000 /* @ECU_Address@GOLF_HighBeam@ */ /end MEASUREMENT
/begin MEASUREMENT GOLF_BlinkerLeft "" FLOAT32_IEEE Ecotron_CM_single 0 0 -3.4E+38 3.4E+38 ECU_ADDRESS 0x0000 /* @ECU_Address@GOLF_BlinkerLeft@ */ /end MEASUREMENT
/begin MEASUREMENT GOLF_BlinkerRight "" FLOAT32_IEEE Ecotron_CM_single 0 0 -3.4E+38 3.4E+38 ECU_ADDRESS 0x0000 /* @ECU_Address@GOLF_BlinkerRight@ */ /end MEASUREMENT
/begin MEASUREMENT GOLF_LWIQbit_SteeringWheelAngle "" FLOAT32_IEEE Ecotron_CM_single 0 0 -3.4E+38 3.4E+38 ECU_ADDRESS 0x0000 /* @ECU_Address@GOLF_LWIQbit_SteeringWheelAngle@ */ /end MEASUREMENT
/begin MEASUREMENT GOLF_LWI_SteeringWheelAngle "" FLOAT32_IEEE Ecotron_CM_single 0 0 -3.4E+38 3.4E+38 ECU_ADDRESS 0x0000 /* @ECU_Address@GOLF_LWI_SteeringWheelAngle@ */ /end MEASUREMENT
/begin MEASUREMENT GOLF_LWIVZ_SteeringWheelAngle "" FLOAT32_IEEE Ecotron_CM_single 0 0 -3.4E+38 3.4E+38 ECU_ADDRESS 0x0000 /* @ECU_Address@GOLF_LWIVZ_SteeringWheelAngle@ */ /end MEASUREMENT
/begin MEASUREMENT GOLF_LWIVZ_SteeringWheelAngle_Speed "" FLOAT32_IEEE Ecotron_CM_single 0 0 -3.4E+38 3.4E+38 ECU_ADDRESS 0x0000 /* @ECU_Address@GOLF_LWIVZ_SteeringWheelAngle_Speed@ */ /end MEASUREMENT
/begin MEASUREMENT GOLF_LWI_SteeringWheelAngle_Speed "" FLOAT32_IEEE Ecotron_CM_single 0 0 -3.4E+38 3.4E+38 ECU_ADDRESS 0x0000 /* @ECU_Address@GOLF_LWI_SteeringWheelAngle_Speed@ */ /end MEASUREMENT
/begin MEASUREMENT Steering_Angle "" FLOAT32_IEEE Ecotron_CM_single 0 0 -3.4E+38 3.4E+38 ECU_ADDRESS 0x0000 /* @ECU_Address@Steering_Angle@ */ /end MEASUREMENT
/begin MEASUREMENT GOLF_Fuel "" FLOAT32_IEEE Ecotron_CM_single_liter 0 0 -3.4E+38 3.4E+38 ECU_ADDRESS 0x0000 /* @ECU_Address@GOLF_Fuel@ */ /end MEASUREMENT
/begin MEASUREMENT GOLF_AcceleratorRawValur "" FLOAT32_IEEE Ecotron_CM_single 0 0 -3.4E+38 3.4E+38 ECU_ADDRESS 0x0000 /* @ECU_Address@GOLF_AcceleratorRawValur@ */ /end MEASUREMENT
/begin MEASUREMENT SteeringWheelRateOvrMsr "" FLOAT32_IEEE Ecotron_CM_single 0 0 -3.4E+38 3.4E+38 ECU_ADDRESS 0x0000 /* @ECU_Address@SteeringWheelRateOvrMsr@ */ /end MEASUREMENT
/begin MEASUREMENT Steering_Set_PosOvrMsr "" FLOAT32_IEEE Ecotron_CM_single 0 0 -3.4E+38 3.4E+38 ECU_ADDRESS 0x0000 /* @ECU_Address@Steering_Set_PosOvrMsr@ */ /end MEASUREMENT
/begin MEASUREMENT Steering_ControlModeOvrMsr "" FLOAT32_IEEE Ecotron_CM_single 0 0 -3.4E+38 3.4E+38 ECU_ADDRESS 0x0000 /* @ECU_Address@Steering_ControlModeOvrMsr@ */ /end MEASUREMENT
/begin MEASUREMENT Steering_ResetCommandOvrMsr "" FLOAT32_IEEE Ecotron_CM_single 0 0 -3.4E+38 3.4E+38 ECU_ADDRESS 0x0000 /* @ECU_Address@Steering_ResetCommandOvrMsr@ */ /end MEASUREMENT
/begin MEASUREMENT PDS_CH9Current "" FLOAT32_IEEE Ecotron_CM_single 0 0 -3.4E+38 3.4E+38 ECU_ADDRESS 0x0000 /* @ECU_Address@PDS_CH9Current@ */ /end MEASUREMENT
/begin MEASUREMENT PDS_CH10Current "" FLOAT32_IEEE Ecotron_CM_single 0 0 -3.4E+38 3.4E+38 ECU_ADDRESS 0x0000 /* @ECU_Address@PDS_CH10Current@ */ /end MEASUREMENT
/begin MEASUREMENT PDS_CH5Current "" FLOAT32_IEEE Ecotron_CM_single 0 0 -3.4E+38 3.4E+38 ECU_ADDRESS 0x0000 /* @ECU_Address@PDS_CH5Current@ */ /end MEASUREMENT
/begin MEASUREMENT PDS_CH6Current "" FLOAT32_IEEE Ecotron_CM_single 0 0 -3.4E+38 3.4E+38 ECU_ADDRESS 0x0000 /* @ECU_Address@PDS_CH6Current@ */ /end MEASUREMENT
/begin MEASUREMENT PDS_CH7Current "" FLOAT32_IEEE Ecotron_CM_single 0 0 -3.4E+38 3.4E+38 ECU_ADDRESS 0x0000 /* @ECU_Address@PDS_CH7Current@ */ /end MEASUREMENT
/begin MEASUREMENT PDS_CH8Current "" FLOAT32_IEEE Ecotron_CM_single 0 0 -3.4E+38 3.4E+38 ECU_ADDRESS 0x0000 /* @ECU_Address@PDS_CH8Current@ */ /end MEASUREMENT
/begin MEASUREMENT PDS_CH1Current "" FLOAT32_IEEE Ecotron_CM_single 0 0 -3.4E+38 3.4E+38 ECU_ADDRESS 0x0000 /* @ECU_Address@PDS_CH1Current@ */ /end MEASUREMENT
/begin MEASUREMENT PDS_CH2Current "" FLOAT32_IEEE Ecotron_CM_single 0 0 -3.4E+38 3.4E+38 ECU_ADDRESS 0x0000 /* @ECU_Address@PDS_CH2Current@ */ /end MEASUREMENT
/begin MEASUREMENT PDS_CH3Current "" FLOAT32_IEEE Ecotron_CM_single 0 0 -3.4E+38 3.4E+38 ECU_ADDRESS 0x0000 /* @ECU_Address@PDS_CH3Current@ */ /end MEASUREMENT
/begin MEASUREMENT PDS_CH4Current "" FLOAT32_IEEE Ecotron_CM_single 0 0 -3.4E+38 3.4E+38 ECU_ADDRESS 0x0000 /* @ECU_Address@PDS_CH4Current@ */ /end MEASUREMENT
/begin MEASUREMENT GOLF_rxESPBrakePressure "" FLOAT32_IEEE Ecotron_CM_single 0 0 -3.4E+38 3.4E+38 ECU_ADDRESS 0x0000 /* @ECU_Address@GOLF_rxESPBrakePressure@ */ /end MEASUREMENT
/begin MEASUREMENT GOLF_rxACC "" FLOAT32_IEEE Ecotron_CM_single 0 0 -3.4E+38 3.4E+38 ECU_ADDRESS 0x0000 /* @ECU_Address@GOLF_rxACC@ */ /end MEASUREMENT
/begin MEASUREMENT GOLF_Fuel_ratio "" FLOAT32_IEEE Ecotron_CM_single_liter 0 0 -3.4E+38 3.4E+38 ECU_ADDRESS 0x0000 /* @ECU_Address@GOLF_Fuel_ratio@ */ /end MEASUREMENT
/begin MEASUREMENT Steering_Angle_Speed "" FLOAT32_IEEE Ecotron_CM_single 0 0 -3.4E+38 3.4E+38 ECU_ADDRESS 0x0000 /* @ECU_Address@Steering_Angle_Speed@ */ /end MEASUREMENT
/begin MEASUREMENT gear_cnt "" FLOAT32_IEEE Ecotron_CM_single 0 0 -3.4E+38 3.4E+38 ECU_ADDRESS 0x0000 /* @ECU_Address@gear_cnt@ */ /end MEASUREMENT
/begin MEASUREMENT GOLF_GearLevel "" FLOAT32_IEEE Ecotron_CM_single 0 0 -3.4E+38 3.4E+38 ECU_ADDRESS 0x0000 /* @ECU_Address@GOLF_GearLevel@ */ /end MEASUREMENT
/begin MEASUREMENT PC_FrontwheelMsg_Freq "" FLOAT32_IEEE Ecotron_CM_single 0 0 -3.4E+38 3.4E+38 ECU_ADDRESS 0x0000 /* @ECU_Address@PC_FrontwheelMsg_Freq@ */ /end MEASUREMENT
/begin MEASUREMENT debug_filtered_ACC "" FLOAT32_IEEE Ecotron_CM_single 0 0 -3.4E+38 3.4E+38 ECU_ADDRESS 0x0000 /* @ECU_Address@debug_filtered_ACC@ */ /end MEASUREMENT
/begin MEASUREMENT debug_EPASsetsteer "" FLOAT32_IEEE Ecotron_CM_single 0 0 -3.4E+38 3.4E+38 ECU_ADDRESS 0x0000 /* @ECU_Address@debug_EPASsetsteer@ */ /end MEASUREMENT
/begin MEASUREMENT debug_EPASspeedlimit "" FLOAT32_IEEE Ecotron_CM_single 0 0 -3.4E+38 3.4E+38 ECU_ADDRESS 0x0000 /* @ECU_Address@debug_EPASspeedlimit@ */ /end MEASUREMENT
/begin MEASUREMENT GOLF_CurrentGear "" UBYTE Ecotron_CM_uint8 0 0 0 255 ECU_ADDRESS 0x0000 /* @ECU_Address@GOLF_CurrentGear@ */ /end MEASUREMENT
/begin MEASUREMENT GOLF_StartStop "" UBYTE Ecotron_CM_uint8 0 0 0 255 ECU_ADDRESS 0x0000 /* @ECU_Address@GOLF_StartStop@ */ /end MEASUREMENT
/begin MEASUREMENT PDS_Status1 "" UBYTE Ecotron_CM_uint8 0 0 0 255 ECU_ADDRESS 0x0000 /* @ECU_Address@PDS_Status1@ */ /end MEASUREMENT
/begin MEASUREMENT PDS_Status2 "" UBYTE Ecotron_CM_uint8 0 0 0 255 ECU_ADDRESS 0x0000 /* @ECU_Address@PDS_Status2@ */ /end MEASUREMENT
/begin MEASUREMENT PDS_Status3 "" UBYTE Ecotron_CM_uint8 0 0 0 255 ECU_ADDRESS 0x0000 /* @ECU_Address@PDS_Status3@ */ /end MEASUREMENT
/begin MEASUREMENT PDS_Status4 "" UBYTE Ecotron_CM_uint8 0 0 0 255 ECU_ADDRESS 0x0000 /* @ECU_Address@PDS_Status4@ */ /end MEASUREMENT
/begin MEASUREMENT PDS_Status5 "" UBYTE Ecotron_CM_uint8 0 0 0 255 ECU_ADDRESS 0x0000 /* @ECU_Address@PDS_Status5@ */ /end MEASUREMENT
/begin MEASUREMENT PDS_Status6 "" UBYTE Ecotron_CM_uint8 0 0 0 255 ECU_ADDRESS 0x0000 /* @ECU_Address@PDS_Status6@ */ /end MEASUREMENT
/begin MEASUREMENT PDS_Status7 "" UBYTE Ecotron_CM_uint8 0 0 0 255 ECU_ADDRESS 0x0000 /* @ECU_Address@PDS_Status7@ */ /end MEASUREMENT
/begin MEASUREMENT PDS_Status8 "" UBYTE Ecotron_CM_uint8 0 0 0 255 ECU_ADDRESS 0x0000 /* @ECU_Address@PDS_Status8@ */ /end MEASUREMENT
/begin MEASUREMENT PDS_Status9 "" UBYTE Ecotron_CM_uint8 0 0 0 255 ECU_ADDRESS 0x0000 /* @ECU_Address@PDS_Status9@ */ /end MEASUREMENT
/begin MEASUREMENT PDS_Status10 "" UBYTE Ecotron_CM_uint8 0 0 0 255 ECU_ADDRESS 0x0000 /* @ECU_Address@PDS_Status10@ */ /end MEASUREMENT
/begin MEASUREMENT PDS_Errors "" UBYTE Ecotron_CM_uint8 0 0 0 255 ECU_ADDRESS 0x0000 /* @ECU_Address@PDS_Errors@ */ /end MEASUREMENT
/begin MEASUREMENT PC_blinker "" UBYTE Ecotron_CM_uint8 0 0 0 255 ECU_ADDRESS 0x0000 /* @ECU_Address@PC_blinker@ */ /end MEASUREMENT
/begin MEASUREMENT PC_headlight "" UBYTE Ecotron_CM_uint8 0 0 0 255 ECU_ADDRESS 0x0000 /* @ECU_Address@PC_headlight@ */ /end MEASUREMENT
/begin MEASUREMENT PC_wiper "" UBYTE Ecotron_CM_uint8 0 0 0 255 ECU_ADDRESS 0x0000 /* @ECU_Address@PC_wiper@ */ /end MEASUREMENT
/begin MEASUREMENT PC_gear "" UBYTE Ecotron_CM_uint8 0 0 0 255 ECU_ADDRESS 0x0000 /* @ECU_Address@PC_gear@ */ /end MEASUREMENT
/begin MEASUREMENT PC_mode "" UBYTE Ecotron_CM_uint8 0 0 0 255 ECU_ADDRESS 0x0000 /* @ECU_Address@PC_mode@ */ /end MEASUREMENT
/begin MEASUREMENT PC_handBrake "" UBYTE Ecotron_CM_uint8 0 0 0 255 ECU_ADDRESS 0x0000 /* @ECU_Address@PC_handBrake@ */ /end MEASUREMENT
/begin MEASUREMENT PC_LongMode "" UBYTE Ecotron_CM_uint8 0 0 0 255 ECU_ADDRESS 0x0000 /* @ECU_Address@PC_LongMode@ */ /end MEASUREMENT
/begin MEASUREMENT Brake_ResetOvrMsr "" UBYTE Ecotron_CM_uint8 0 0 0 255 ECU_ADDRESS 0x0000 /* @ECU_Address@Brake_ResetOvrMsr@ */ /end MEASUREMENT
/begin MEASUREMENT Set_GearOvrMsr "" UBYTE Ecotron_CM_uint8 0 0 0 255 ECU_ADDRESS 0x0000 /* @ECU_Address@Set_GearOvrMsr@ */ /end MEASUREMENT
/begin MEASUREMENT debug_EPASmode "" UBYTE Ecotron_CM_uint8 0 0 0 255 ECU_ADDRESS 0x0000 /* @ECU_Address@debug_EPASmode@ */ /end MEASUREMENT
/begin MEASUREMENT Diag_isMotorrunning "" UBYTE Ecotron_CM_boolean 0 0 0 1 ECU_ADDRESS 0x0000 /* @ECU_Address@Diag_isMotorrunning@ */ /end MEASUREMENT
/begin MEASUREMENT Diag_KL75 "" UBYTE Ecotron_CM_boolean 0 0 0 1 ECU_ADDRESS 0x0000 /* @ECU_Address@Diag_KL75@ */ /end MEASUREMENT
/begin MEASUREMENT Diag_PDS_HeartbeatErr "" UBYTE Ecotron_CM_boolean 0 0 0 1 ECU_ADDRESS 0x0000 /* @ECU_Address@Diag_PDS_HeartbeatErr@ */ /end MEASUREMENT
/begin MEASUREMENT Diag_PDS_BUSErr "" UBYTE Ecotron_CM_boolean 0 0 0 1 ECU_ADDRESS 0x0000 /* @ECU_Address@Diag_PDS_BUSErr@ */ /end MEASUREMENT
/begin MEASUREMENT Diag_By_wirePowerErr "" UBYTE Ecotron_CM_boolean 0 0 0 1 ECU_ADDRESS 0x0000 /* @ECU_Address@Diag_By_wirePowerErr@ */ /end MEASUREMENT
/begin MEASUREMENT Diag_EPASPowerErr "" UBYTE Ecotron_CM_boolean 0 0 0 1 ECU_ADDRESS 0x0000 /* @ECU_Address@Diag_EPASPowerErr@ */ /end MEASUREMENT
/begin MEASUREMENT Diag_BrakePowerErr "" UBYTE Ecotron_CM_boolean 0 0 0 1 ECU_ADDRESS 0x0000 /* @ECU_Address@Diag_BrakePowerErr@ */ /end MEASUREMENT
/begin MEASUREMENT EPAS_MotorConnection "" UBYTE Ecotron_CM_boolean 0 0 0 1 ECU_ADDRESS 0x0000 /* @ECU_Address@EPAS_MotorConnection@ */ /end MEASUREMENT
/begin MEASUREMENT EPAS_OverCurrent "" UBYTE Ecotron_CM_boolean 0 0 0 1 ECU_ADDRESS 0x0000 /* @ECU_Address@EPAS_OverCurrent@ */ /end MEASUREMENT
/begin MEASUREMENT EPAS_AngleSensorConnection "" UBYTE Ecotron_CM_boolean 0 0 0 1 ECU_ADDRESS 0x0000 /* @ECU_Address@EPAS_AngleSensorConnection@ */ /end MEASUREMENT
/begin MEASUREMENT EPAS_DriverIntervention "" UBYTE Ecotron_CM_boolean 0 0 0 1 ECU_ADDRESS 0x0000 /* @ECU_Address@EPAS_DriverIntervention@ */ /end MEASUREMENT
/begin MEASUREMENT EPAS_ECUReset "" UBYTE Ecotron_CM_boolean 0 0 0 1 ECU_ADDRESS 0x0000 /* @ECU_Address@EPAS_ECUReset@ */ /end MEASUREMENT
/begin MEASUREMENT EPAS_UnderVoltage "" UBYTE Ecotron_CM_boolean 0 0 0 1 ECU_ADDRESS 0x0000 /* @ECU_Address@EPAS_UnderVoltage@ */ /end MEASUREMENT
/begin MEASUREMENT BBW_MotorConnection "" UBYTE Ecotron_CM_boolean 0 0 0 1 ECU_ADDRESS 0x0000 /* @ECU_Address@BBW_MotorConnection@ */ /end MEASUREMENT
/begin MEASUREMENT BBW_OverCurrent "" UBYTE Ecotron_CM_boolean 0 0 0 1 ECU_ADDRESS 0x0000 /* @ECU_Address@BBW_OverCurrent@ */ /end MEASUREMENT
/begin MEASUREMENT BBW_AngleSensorConnection "" UBYTE Ecotron_CM_boolean 0 0 0 1 ECU_ADDRESS 0x0000 /* @ECU_Address@BBW_AngleSensorConnection@ */ /end MEASUREMENT
/begin MEASUREMENT BBW_DriverIntervention "" UBYTE Ecotron_CM_boolean 0 0 0 1 ECU_ADDRESS 0x0000 /* @ECU_Address@BBW_DriverIntervention@ */ /end MEASUREMENT
/begin MEASUREMENT BBW_ECUReset "" UBYTE Ecotron_CM_boolean 0 0 0 1 ECU_ADDRESS 0x0000 /* @ECU_Address@BBW_ECUReset@ */ /end MEASUREMENT
/begin MEASUREMENT BBW_UnderVoltage "" UBYTE Ecotron_CM_boolean 0 0 0 1 ECU_ADDRESS 0x0000 /* @ECU_Address@BBW_UnderVoltage@ */ /end MEASUREMENT
/begin MEASUREMENT BBW_CalibrationErr "" UBYTE Ecotron_CM_boolean 0 0 0 1 ECU_ADDRESS 0x0000 /* @ECU_Address@BBW_CalibrationErr@ */ /end MEASUREMENT
/begin MEASUREMENT BBW_OnCalibration "" UBYTE Ecotron_CM_boolean 0 0 0 1 ECU_ADDRESS 0x0000 /* @ECU_Address@BBW_OnCalibration@ */ /end MEASUREMENT
/begin MEASUREMENT EPAS_DriverIntervention_overrideOvrMsr "" UBYTE Ecotron_CM_boolean 0 0 0 1 ECU_ADDRESS 0x0000 /* @ECU_Address@EPAS_DriverIntervention_overrideOvrMsr@ */ /end MEASUREMENT
/begin MEASUREMENT debug_PCheardbeatOvrMsr "" UBYTE Ecotron_CM_boolean 0 0 0 1 ECU_ADDRESS 0x0000 /* @ECU_Address@debug_PCheardbeatOvrMsr@ */ /end MEASUREMENT
/begin MEASUREMENT debug_Errors "" UBYTE Ecotron_CM_boolean 0 0 0 1 ECU_ADDRESS 0x0000 /* @ECU_Address@debug_Errors@ */ /end MEASUREMENT
/begin MEASUREMENT debug_otonomEnableOvrMsr "" UBYTE Ecotron_CM_boolean 0 0 0 1 ECU_ADDRESS 0x0000 /* @ECU_Address@debug_otonomEnableOvrMsr@ */ /end MEASUREMENT
/begin MEASUREMENT debug_otonomDisableOvrMsr "" UBYTE Ecotron_CM_boolean 0 0 0 1 ECU_ADDRESS 0x0000 /* @ECU_Address@debug_otonomDisableOvrMsr@ */ /end MEASUREMENT
/begin MEASUREMENT Button_Hazard_LightOvrMsr "" UBYTE Ecotron_CM_boolean 0 0 0 1 ECU_ADDRESS 0x0000 /* @ECU_Address@Button_Hazard_LightOvrMsr@ */ /end MEASUREMENT
/begin MEASUREMENT Button_Headlight_FlasherOvrMsr "" UBYTE Ecotron_CM_boolean 0 0 0 1 ECU_ADDRESS 0x0000 /* @ECU_Address@Button_Headlight_FlasherOvrMsr@ */ /end MEASUREMENT
/begin MEASUREMENT Button_HighBeamOvrMsr "" UBYTE Ecotron_CM_boolean 0 0 0 1 ECU_ADDRESS 0x0000 /* @ECU_Address@Button_HighBeamOvrMsr@ */ /end MEASUREMENT
/begin MEASUREMENT Button_Left_BlinkerOvrMsr "" UBYTE Ecotron_CM_boolean 0 0 0 1 ECU_ADDRESS 0x0000 /* @ECU_Address@Button_Left_BlinkerOvrMsr@ */ /end MEASUREMENT
/begin MEASUREMENT Button_Right_BlinkerOvrMsr "" UBYTE Ecotron_CM_boolean 0 0 0 1 ECU_ADDRESS 0x0000 /* @ECU_Address@Button_Right_BlinkerOvrMsr@ */ /end MEASUREMENT
/begin MEASUREMENT Buzz_controlOvrMsr "" UBYTE Ecotron_CM_boolean 0 0 0 1 ECU_ADDRESS 0x0000 /* @ECU_Address@Buzz_controlOvrMsr@ */ /end MEASUREMENT
/begin MEASUREMENT PwrM_flgKeyOnDelay "" UBYTE Ecotron_CM_boolean 0 0 0 1 ECU_ADDRESS 0x0000 /* @ECU_Address@PwrM_flgKeyOnDelay@ */ /end MEASUREMENT
/begin MEASUREMENT PwrM_flgKeyOnRaw "" UBYTE Ecotron_CM_boolean 0 0 0 1 ECU_ADDRESS 0x0000 /* @ECU_Address@PwrM_flgKeyOnRaw@ */ /end MEASUREMENT
/begin MEASUREMENT debug_Mode "" UBYTE Ecotron_CM_boolean 0 0 0 1 ECU_ADDRESS 0x0000 /* @ECU_Address@debug_Mode@ */ /end MEASUREMENT
/begin MEASUREMENT debug_stopmode "" UBYTE Ecotron_CM_boolean 0 0 0 1 ECU_ADDRESS 0x0000 /* @ECU_Address@debug_stopmode@ */ /end MEASUREMENT
/begin MEASUREMENT debug_EPAS_ECU_reset "" UBYTE Ecotron_CM_boolean 0 0 0 1 ECU_ADDRESS 0x0000 /* @ECU_Address@debug_EPAS_ECU_reset@ */ /end MEASUREMENT
/begin MEASUREMENT GOLF_HazardLight "" UBYTE Ecotron_CM_boolean 0 0 0 1 ECU_ADDRESS 0x0000 /* @ECU_Address@GOLF_HazardLight@ */ /end MEASUREMENT
/begin COMPU_METHOD Ecotron_CM_single "Q = V" RAT_FUNC "%8.6" "" COEFFS 0 1 0 0 0 1 /end COMPU_METHOD
/begin COMPU_METHOD Ecotron_CM_boolean "Q = V" RAT_FUNC "%1.0" "" COEFFS 0 1 0 0 0 1 /end COMPU_METHOD
/begin COMPU_METHOD Ecotron_CM_uint8 "Q = V" RAT_FUNC "%3.0" "" COEFFS 0 1 0 0 0 1 /end COMPU_METHOD
/begin COMPU_METHOD Ecotron_CM_uint32 "Q = V" RAT_FUNC "%10.0" "" COEFFS 0 1 0 0 0 1 /end COMPU_METHOD
/begin COMPU_METHOD Ecotron_CM_single_liter "Q = V" RAT_FUNC "%8.6" "liter" COEFFS 0 1 0 0 0 1 /end COMPU_METHOD
/begin GROUP Ecotron "Ecotron" /* Root */ ROOT
 /begin SUB_GROUP Root_Input Root_Main_ Root_Power_Management_Example Root_Subsystem4 /end SUB_GROUP
 /begin REF_CHARACTERISTIC CANA_recover CANB_recover CANC_recover /end REF_CHARACTERISTIC
/end GROUP
/begin GROUP Root_Input "Ecotron/Input" /begin SUB_GROUP S2_By_wire S2_Golf S2_PC /end SUB_GROUP /end GROUP
/begin GROUP Root_Main_ "Ecotron/Main "
 /begin SUB_GROUP S3_Err_Handler S3_Gear S3_LateralControl S3_LongControl_ S3_Mode_Select /end SUB_GROUP
/end GROUP
/begin GROUP Root_Power_Management_Example "Ecotron/Power Management Example" /begin SUB_GROUP S4_Power_Off_Management /end SUB_GROUP /end GROUP
/begin GROUP Root_Subsystem4 "Ecotron/Subsystem4" /begin SUB_GROUP S8_Brake S8_Button_cntrl_ S8_Gas S8_Steering_Control_ /end SUB_GROUP /end GROUP
/begin GROUP S2_By_wire "Ecotron/Input/By-wire"
 /begin SUB_GROUP S10_PDS S10_Robeff_Brake_ECU S10_Robeff_EPAS_ECU S10_Throttle_Controller /end SUB_GROUP
/end GROUP
/begin GROUP S2_Golf "Ecotron/Input/Golf"
 /begin SUB_GROUP S11_BCM_01 S11_Brake S11_EPB_01 S11_ESP_05 S11_Gateway_72 S11_Getriebe_1 S11_Getriebe_11 S11_Getriebe_2 S11_Kombi_02 S11_LWl S11_Motor_11 S11_Motor_12 S11_Motor_14 S11_Motor_20 S11_Subsystem S11_WheelSpeed /end SUB_GROUP
/end GROUP
/begin GROUP S2_PC "Ecotron/Input/PC"
 /begin SUB_GROUP S12_FrontWheelCommands S12_LongitudinalCommands S12_LongitudinalCommandsV2 S12_Vehicle_Commands /end SUB_GROUP
/end GROUP
/begin GROUP S3_Err_Handler "Ecotron/Main /Err Handler" /begin SUB_GROUP S193_Check_PDS_Errors S193_MotorStatus /end SUB_GROUP /end GROUP
/begin GROUP S3_Gear "Ecotron/Main /Gear" /begin SUB_GROUP S194_Gear_Control S194__Override_Probe /end SUB_GROUP /end GROUP
/begin GROUP S3_LateralControl "Ecotron/Main /LateralControl" /begin REF_CHARACTERISTIC EPAS_MaxSpeed /end REF_CHARACTERISTIC
 /begin REF_MEASUREMENT debug_EPAS_ECU_reset debug_EPASmode debug_EPASsetsteer debug_EPASspeedlimit /end REF_MEASUREMENT
/end GROUP
/begin GROUP S3_LongControl_ "Ecotron/Main /LongControl " /begin SUB_GROUP S196_ACC_Control S196_Brake_Calib_logic /end SUB_GROUP /end GROUP
/begin GROUP S3_Mode_Select "Ecotron/Main /Mode Select"
 /begin SUB_GROUP S197__Override_Probe S197__Override_Probe1 S197__Override_Probe2 /end SUB_GROUP
 /begin REF_MEASUREMENT debug_Errors debug_Mode /end REF_MEASUREMENT
/end GROUP
/begin GROUP S4_Power_Off_Management "Ecotron/Power Management Example/Power Off Management" /begin SUB_GROUP S411_Get_flgKeyOn S411_TOfD_xxxx1 /end SUB_GROUP /end GROUP
/begin GROUP S8_Brake "Ecotron/Subsystem4/Brake" /begin SUB_GROUP S436__Override_Probe S436__Override_Probe1 /end SUB_GROUP /begin REF_CHARACTERISTIC Brake_ControlMode Brake_SetDuty /end REF_CHARACTERISTIC /end GROUP
/begin GROUP S8_Button_cntrl_ "Ecotron/Subsystem4/Button cntrl "
 /begin SUB_GROUP S437_Subsystem4 S437__Override_Probe S437__Override_Probe1 S437__Override_Probe2 S437__Override_Probe3 S437__Override_Probe4 S437__Override_Probe5 /end SUB_GROUP
/end GROUP
/begin GROUP S8_Gas "Ecotron/Subsystem4/Gas" /begin SUB_GROUP S438__Override_Probe S438__Override_Probe1 /end SUB_GROUP /end GROUP
/begin GROUP S8_Steering_Control_ "Ecotron/Subsystem4/Steering Control "
 /begin SUB_GROUP S442__Override_Probe S442__Override_Probe1 S442__Override_Probe2 S442__Override_Probe3 /end SUB_GROUP
/end GROUP
/begin GROUP S10_PDS "Ecotron/Input/By-wire/PDS"
 /begin SUB_GROUP S13_Subsystem S13_Subsystem1 S13_Subsystem2 S13_Subsystem3 S13_Subsystem4 /end SUB_GROUP
/end GROUP
/begin GROUP S10_Robeff_Brake_ECU "Ecotron/Input/By-wire/Robeff Brake ECU"
 /begin SUB_GROUP S14_Robeff_Brake_FbMsg1 S14_Robeff_Brake_FbMsg2 S14_Robeff_Brake_FbMsg3 /end SUB_GROUP
/end GROUP
/begin GROUP S10_Robeff_EPAS_ECU "Ecotron/Input/By-wire/Robeff EPAS ECU"
 /begin SUB_GROUP S15_Robeff_EPAS_FbMsg1 S15_Robeff_EPAS_FbMsg2 S15_Robeff_EPAS_FbMsg3 /end SUB_GROUP
/end GROUP
/begin GROUP S10_Throttle_Controller "Ecotron/Input/By-wire/Throttle Controller"
 /begin REF_MEASUREMENT THROTTLE_CurrentPedalPos THROTTLE_ECUTimeout THROTTLE_PedalConnectionError /end REF_MEASUREMENT
/end GROUP
/begin GROUP S11_BCM_01 "Ecotron/Input/Golf/BCM_01" /begin SUB_GROUP S100_Subsystem /end SUB_GROUP /end GROUP
/begin GROUP S11_Brake "Ecotron/Input/Golf/Brake" /begin REF_MEASUREMENT GOLF_BrakePedalPos /end REF_MEASUREMENT /end GROUP
/begin GROUP S11_EPB_01 "Ecotron/Input/Golf/EPB_01" /begin REF_MEASUREMENT GOLF_HandBrakeStatus GOLF_LongitudinalAcceleration /end REF_MEASUREMENT /end GROUP
/begin GROUP S11_ESP_05 "Ecotron/Input/Golf/ESP_05" /begin REF_MEASUREMENT GOLF_rxESPBrakePressure /end REF_MEASUREMENT /end GROUP
/begin GROUP S11_Gateway_72 "Ecotron/Input/Golf/Gateway_72" /begin REF_MEASUREMENT GOLF_BlinkerLeft GOLF_BlinkerRight GOLF_HighBeam /end REF_MEASUREMENT /end GROUP
/begin GROUP S11_Getriebe_1 "Ecotron/Input/Golf/Getriebe_1" /begin REF_MEASUREMENT GOLF_rxACC /end REF_MEASUREMENT /end GROUP
/begin GROUP S11_Getriebe_11 "Ecotron/Input/Golf/Getriebe_11" /begin REF_MEASUREMENT GOLF_GearLevel /end REF_MEASUREMENT /end GROUP
/begin GROUP S11_Getriebe_2 "Ecotron/Input/Golf/Getriebe_2" /begin REF_MEASUREMENT GOLF_rxPitch GOLF_rxVehiclemass /end REF_MEASUREMENT /end GROUP
/begin GROUP S11_Kombi_02 "Ecotron/Input/Golf/Kombi_02" /begin REF_MEASUREMENT GOLF_Fuel GOLF_Fuel_ratio /end REF_MEASUREMENT /end GROUP
/begin GROUP S11_LWl "Ecotron/Input/Golf/LWl"
 /begin REF_MEASUREMENT GOLF_LWIQbit_SteeringWheelAngle GOLF_LWIVZ_SteeringWheelAngle GOLF_LWIVZ_SteeringWheelAngle_Speed GOLF_LWI_SteeringWheelAngle GOLF_LWI_SteeringWheelAngle_Speed Steering_Angle Steering_Angle_Speed /end REF_MEASUREMENT
/end GROUP
/begin GROUP S11_Motor_11 "Ecotron/Input/Golf/Motor_11" /begin REF_MEASUREMENT GOLF_MotorTorque_filtered GOLF_MotorTorque_raw /end REF_MEASUREMENT /end GROUP
/begin GROUP S11_Motor_12 "Ecotron/Input/Golf/Motor_12" /begin REF_MEASUREMENT GOLF_MotorRPM /end REF_MEASUREMENT /end GROUP
/begin GROUP S11_Motor_14 "Ecotron/Input/Golf/Motor_14" /begin REF_MEASUREMENT GOLF_KL75 GOLF_StartStop /end REF_MEASUREMENT /end GROUP
/begin GROUP S11_Motor_20 "Ecotron/Input/Golf/Motor_20" /begin REF_MEASUREMENT GOLF_AcceleratorRawValur /end REF_MEASUREMENT /end GROUP
/begin GROUP S11_Subsystem "Ecotron/Input/Golf/Subsystem" /begin REF_MEASUREMENT GOLF_CurrentGear /end REF_MEASUREMENT /end GROUP
/begin GROUP S11_WheelSpeed "Ecotron/Input/Golf/WheelSpeed"
 /begin REF_MEASUREMENT GOLF_BLWheelSpeed GOLF_BRWheelSpeed GOLF_FLWheelSpeed GOLF_FRWheelSpeed /end REF_MEASUREMENT
/end GROUP
/begin GROUP S12_FrontWheelCommands "Ecotron/Input/PC/FrontWheelCommands" /begin SUB_GROUP S169_Subsystem1 /end SUB_GROUP
 /begin REF_MEASUREMENT PC_FrontwheelMsg_cnt PC_SetFrontWheelAngel_Rate PC_SetFrontWheelAngle /end REF_MEASUREMENT
/end GROUP
/begin GROUP S12_LongitudinalCommands "Ecotron/Input/PC/LongitudinalCommands" /begin SUB_GROUP S170__Override_Probe /end SUB_GROUP /begin REF_MEASUREMENT PC_SetLimitVel PC_SetLongAcc /end REF_MEASUREMENT /end GROUP
/begin GROUP S12_LongitudinalCommandsV2 "Ecotron/Input/PC/LongitudinalCommandsV2" /begin REF_MEASUREMENT PC_SetBrakePos PC_SetGasPos /end REF_MEASUREMENT /end GROUP
/begin GROUP S12_Vehicle_Commands "Ecotron/Input/PC/Vehicle_Commands"
 /begin REF_MEASUREMENT PC_LongMode PC_blinker PC_gear PC_handBrake PC_headlight PC_mode PC_wiper /end REF_MEASUREMENT
/end GROUP
/begin GROUP S193_Check_PDS_Errors "Ecotron/Main /Err Handler/Check PDS Errors"
 /begin REF_MEASUREMENT Diag_BrakePowerErr Diag_By_wirePowerErr Diag_EPASPowerErr Diag_PDS_BUSErr Diag_PDS_HeartbeatErr /end REF_MEASUREMENT
/end GROUP
/begin GROUP S193_MotorStatus "Ecotron/Main /Err Handler/MotorStatus" /begin REF_MEASUREMENT Diag_KL75 Diag_isMotorrunning /end REF_MEASUREMENT /end GROUP
/begin GROUP S194__Override_Probe "Ecotron/Main /Gear/ Override Probe" /begin REF_CHARACTERISTIC Set_GearEnableOvrCal_val Set_GearEnableOvrEn_val /end REF_CHARACTERISTIC /begin REF_MEASUREMENT Set_GearEnableOvrMsr /end REF_MEASUREMENT /end GROUP
/begin GROUP S194_Gear_Control "Ecotron/Main /Gear/Gear_Control" /begin SUB_GROUP S228__Override_Probe /end SUB_GROUP /begin REF_CHARACTERISTIC Delay interval interval2 repeat /end REF_CHARACTERISTIC /begin REF_MEASUREMENT gear_cnt /end REF_MEASUREMENT /end GROUP
/begin GROUP S196_ACC_Control "Ecotron/Main /LongControl /ACC Control" /begin SUB_GROUP S239_Fcalculator_ S239_StopModeDesicion /end SUB_GROUP /end GROUP
/begin GROUP S196_Brake_Calib_logic "Ecotron/Main /LongControl /Brake Calib logic" /begin SUB_GROUP S240__Override_Probe /end SUB_GROUP /end GROUP
/begin GROUP S197__Override_Probe "Ecotron/Main /Mode Select/ Override Probe" /begin REF_CHARACTERISTIC debug_otonomEnableOvrCal_val debug_otonomEnableOvrEn_val /end REF_CHARACTERISTIC /begin REF_MEASUREMENT debug_otonomEnableOvrMsr /end REF_MEASUREMENT /end GROUP
/begin GROUP S197__Override_Probe1 "Ecotron/Main /Mode Select/ Override Probe1" /begin REF_CHARACTERISTIC debug_otonomDisableOvrCal_val debug_otonomDisableOvrEn_val /end REF_CHARACTERISTIC /begin REF_MEASUREMENT debug_otonomDisableOvrMsr /end REF_MEASUREMENT /end GROUP
/begin GROUP S197__Override_Probe2 "Ecotron/Main /Mode Select/ Override Probe2" /begin REF_CHARACTERISTIC debug_PCheardbeatOvrCal_val debug_PCheardbeatOvrEn_val /end REF_CHARACTERISTIC /begin REF_MEASUREMENT debug_PCheardbeatOvrMsr /end REF_MEASUREMENT /end GROUP
/begin GROUP S411_Get_flgKeyOn "Ecotron/Power Management Example/Power Off Management/Get flgKeyOn" /begin REF_MEASUREMENT PwrM_flgKeyOnRaw /end REF_MEASUREMENT /end GROUP
/begin GROUP S411_TOfD_xxxx1 "Ecotron/Power Management Example/Power Off Management/TOfD_xxxx1" /begin REF_MEASUREMENT PwrM_flgKeyOnDelay /end REF_MEASUREMENT /end GROUP
/begin GROUP S436__Override_Probe "Ecotron/Subsystem4/Brake/ Override Probe" /begin REF_CHARACTERISTIC Set_Brake_PosOvrCal_val Set_Brake_PosOvrEn_val /end REF_CHARACTERISTIC /begin REF_MEASUREMENT Set_Brake_PosOvrMsr /end REF_MEASUREMENT /end GROUP
/begin GROUP S436__Override_Probe1 "Ecotron/Subsystem4/Brake/ Override Probe1" /begin REF_CHARACTERISTIC Brake_ResetOvrCal_val Brake_ResetOvrEn_val /end REF_CHARACTERISTIC /begin REF_MEASUREMENT Brake_ResetOvrMsr /end REF_MEASUREMENT /end GROUP
/begin GROUP S437__Override_Probe "Ecotron/Subsystem4/Button cntrl / Override Probe" /begin REF_CHARACTERISTIC Button_Hazard_LightOvrCal_val Button_Hazard_LightOvrEn_val /end REF_CHARACTERISTIC /begin REF_MEASUREMENT Button_Hazard_LightOvrMsr /end REF_MEASUREMENT /end GROUP
/begin GROUP S437__Override_Probe1 "Ecotron/Subsystem4/Button cntrl / Override Probe1" /begin REF_CHARACTERISTIC Button_Left_BlinkerOvrCal_val Button_Left_BlinkerOvrEn_val /end REF_CHARACTERISTIC /begin REF_MEASUREMENT Button_Left_BlinkerOvrMsr /end REF_MEASUREMENT /end GROUP
/begin GROUP S437__Override_Probe2 "Ecotron/Subsystem4/Button cntrl / Override Probe2"
 /begin REF_CHARACTERISTIC Button_Right_BlinkerOvrCal_val Button_Right_BlinkerOvrEn_val /end REF_CHARACTERISTIC
 /begin REF_MEASUREMENT Button_Right_BlinkerOvrMsr /end REF_MEASUREMENT
/end GROUP
/begin GROUP S437__Override_Probe3 "Ecotron/Subsystem4/Button cntrl / Override Probe3" /begin REF_CHARACTERISTIC Button_HighBeamOvrCal_val Button_HighBeamOvrEn_val /end REF_CHARACTERISTIC /begin REF_MEASUREMENT Button_HighBeamOvrMsr /end REF_MEASUREMENT /end GROUP
/begin GROUP S437__Override_Probe4 "Ecotron/Subsystem4/Button cntrl / Override Probe4"
 /begin REF_CHARACTERISTIC Button_Headlight_FlasherOvrCal_val Button_Headlight_FlasherOvrEn_val /end REF_CHARACTERISTIC
 /begin REF_MEASUREMENT Button_Headlight_FlasherOvrMsr /end REF_MEASUREMENT
/end GROUP
/begin GROUP S437__Override_Probe5 "Ecotron/Subsystem4/Button cntrl / Override Probe5" /begin REF_CHARACTERISTIC Buzz_controlOvrCal_val Buzz_controlOvrEn_val /end REF_CHARACTERISTIC /begin REF_MEASUREMENT Buzz_controlOvrMsr /end REF_MEASUREMENT /end GROUP
/begin GROUP S437_Subsystem4 "Ecotron/Subsystem4/Button cntrl /Subsystem4"
 /begin REF_CHARACTERISTIC Buzz_falling_duration Buzz_falling_offduration Buzz_rising_duration /end REF_CHARACTERISTIC
/end GROUP
/begin GROUP S438__Override_Probe "Ecotron/Subsystem4/Gas/ Override Probe" /begin REF_CHARACTERISTIC Set_GasOvrCal_val Set_GasOvrEn_val /end REF_CHARACTERISTIC /begin REF_MEASUREMENT Set_GasOvrMsr /end REF_MEASUREMENT /end GROUP
/begin GROUP S438__Override_Probe1 "Ecotron/Subsystem4/Gas/ Override Probe1"
 /begin REF_CHARACTERISTIC Activate_ThrottleControllerOvrCal_val Activate_ThrottleControllerOvrEn_val /end REF_CHARACTERISTIC
 /begin REF_MEASUREMENT Activate_ThrottleControllerOvrMsr /end REF_MEASUREMENT
/end GROUP
/begin GROUP S442__Override_Probe "Ecotron/Subsystem4/Steering Control / Override Probe" /begin REF_CHARACTERISTIC SteeringWheelRateOvrCal_val SteeringWheelRateOvrEn_val /end REF_CHARACTERISTIC /begin REF_MEASUREMENT SteeringWheelRateOvrMsr /end REF_MEASUREMENT /end GROUP
/begin GROUP S442__Override_Probe1 "Ecotron/Subsystem4/Steering Control / Override Probe1" /begin REF_CHARACTERISTIC Steering_Set_PosOvrCal_val Steering_Set_PosOvrEn_val /end REF_CHARACTERISTIC /begin REF_MEASUREMENT Steering_Set_PosOvrMsr /end REF_MEASUREMENT /end GROUP
/begin GROUP S442__Override_Probe2 "Ecotron/Subsystem4/Steering Control / Override Probe2"
 /begin REF_CHARACTERISTIC Steering_ControlModeOvrCal_val Steering_ControlModeOvrEn_val /end REF_CHARACTERISTIC
 /begin REF_MEASUREMENT Steering_ControlModeOvrMsr /end REF_MEASUREMENT
/end GROUP
/begin GROUP S442__Override_Probe3 "Ecotron/Subsystem4/Steering Control / Override Probe3"
 /begin REF_CHARACTERISTIC Steering_ResetCommandOvrCal_val Steering_ResetCommandOvrEn_val /end REF_CHARACTERISTIC
 /begin REF_MEASUREMENT Steering_ResetCommandOvrMsr /end REF_MEASUREMENT
/end GROUP
/begin GROUP S13_Subsystem "Ecotron/Input/By-wire/PDS/Subsystem"
 /begin REF_MEASUREMENT PDS_Errors PDS_Status1 PDS_Status10 PDS_Status2 PDS_Status3 PDS_Status4 PDS_Status5 PDS_Status6 PDS_Status7 PDS_Status8 PDS_Status9 /end REF_MEASUREMENT
/end GROUP
/begin GROUP S13_Subsystem1 "Ecotron/Input/By-wire/PDS/Subsystem1" /begin REF_MEASUREMENT PDS_CH10Current PDS_CH9Current /end REF_MEASUREMENT /end GROUP
/begin GROUP S13_Subsystem2 "Ecotron/Input/By-wire/PDS/Subsystem2"
 /begin REF_MEASUREMENT PDS_CH5Current PDS_CH6Current PDS_CH7Current PDS_CH8Current /end REF_MEASUREMENT
/end GROUP
/begin GROUP S13_Subsystem3 "Ecotron/Input/By-wire/PDS/Subsystem3"
 /begin REF_MEASUREMENT PDS_CH1Current PDS_CH2Current PDS_CH3Current PDS_CH4Current /end REF_MEASUREMENT
/end GROUP
/begin GROUP S13_Subsystem4 "Ecotron/Input/By-wire/PDS/Subsystem4" /begin REF_MEASUREMENT PDS_BoardTemp PDS_InputCurrent PDS_InputVoltage /end REF_MEASUREMENT /end GROUP
/begin GROUP S14_Robeff_Brake_FbMsg1 "Ecotron/Input/By-wire/Robeff Brake ECU/Robeff Brake FbMsg1" /begin REF_MEASUREMENT BBW_BrakePos BBW_ReferenceBrakePos /end REF_MEASUREMENT /end GROUP
/begin GROUP S14_Robeff_Brake_FbMsg2 "Ecotron/Input/By-wire/Robeff Brake ECU/Robeff Brake FbMsg2"
 /begin REF_MEASUREMENT BBW_BoxTemp BBW_MotorCurrent BBW_MotorDuty BBW_MotorVoltage BBW_RawTorqueA BBW_RawTorqueB /end REF_MEASUREMENT
/end GROUP
/begin GROUP S14_Robeff_Brake_FbMsg3 "Ecotron/Input/By-wire/Robeff Brake ECU/Robeff Brake FbMsg3"
 /begin REF_MEASUREMENT BBW_AngleSensorConnection BBW_CalibrationErr BBW_DriverIntervention BBW_ECUReset BBW_MotorConnection BBW_OnCalibration BBW_OverCurrent BBW_UnderVoltage /end REF_MEASUREMENT
/end GROUP
/begin GROUP S15_Robeff_EPAS_FbMsg1 "Ecotron/Input/By-wire/Robeff EPAS ECU/Robeff EPAS FbMsg1" /begin REF_MEASUREMENT EPAS_ActualSteeringPos EPAS_RefSteerPos /end REF_MEASUREMENT /end GROUP
/begin GROUP S15_Robeff_EPAS_FbMsg2 "Ecotron/Input/By-wire/Robeff EPAS ECU/Robeff EPAS FbMsg2"
 /begin REF_MEASUREMENT EPAS_BoxTemp EPAS_MotorCurrent EPAS_MotorDuty EPAS_MotorVoltage EPAS_TorqueA EPAS_TorqueB /end REF_MEASUREMENT
/end GROUP
/begin GROUP S15_Robeff_EPAS_FbMsg3 "Ecotron/Input/By-wire/Robeff EPAS ECU/Robeff EPAS FbMsg3" /begin SUB_GROUP S77__Override_Probe /end SUB_GROUP
 /begin REF_MEASUREMENT EPAS_AngleSensorConnection EPAS_DriverIntervention EPAS_ECUReset EPAS_MotorConnection EPAS_OverCurrent EPAS_UnderVoltage /end REF_MEASUREMENT
/end GROUP
/begin GROUP S100_Subsystem "Ecotron/Input/Golf/BCM_01/Subsystem" /begin REF_MEASUREMENT GOLF_HazardLight /end REF_MEASUREMENT /end GROUP
/begin GROUP S169_Subsystem1 "Ecotron/Input/PC/FrontWheelCommands/Subsystem1" /begin REF_MEASUREMENT PC_FrontwheelMsg_Freq /end REF_MEASUREMENT /end GROUP
/begin GROUP S170__Override_Probe "Ecotron/Input/PC/LongitudinalCommands/ Override Probe" /begin REF_CHARACTERISTIC SetACCOvrCal_val SetACCOvrEn_val /end REF_CHARACTERISTIC /begin REF_MEASUREMENT SetACCOvrMsr /end REF_MEASUREMENT /end GROUP
/begin GROUP S228__Override_Probe "Ecotron/Main /Gear/Gear_Control/ Override Probe" /begin REF_CHARACTERISTIC Set_GearOvrCal_val Set_GearOvrEn_val /end REF_CHARACTERISTIC /begin REF_MEASUREMENT Set_GearOvrMsr /end REF_MEASUREMENT /end GROUP
/begin GROUP S239_Fcalculator_ "Ecotron/Main /LongControl /ACC Control/Fcalculator " /begin SUB_GROUP S241_Acceleration1 S241_Subsystem S241_Subsystem1 /end SUB_GROUP /begin REF_CHARACTERISTIC Compensation_I Compensation_P /end REF_CHARACTERISTIC /begin REF_MEASUREMENT debug_Fr_request debug_set_brake /end REF_MEASUREMENT /end GROUP
/begin GROUP S239_StopModeDesicion "Ecotron/Main /LongControl /ACC Control/StopModeDesicion" /begin REF_MEASUREMENT debug_stopmode /end REF_MEASUREMENT /end GROUP
/begin GROUP S240__Override_Probe "Ecotron/Main /LongControl /Brake Calib logic/ Override Probe" /begin REF_CHARACTERISTIC Brake_CalibCMDOvrCal_val Brake_CalibCMDOvrEn_val /end REF_CHARACTERISTIC /begin REF_MEASUREMENT Brake_CalibCMDOvrMsr /end REF_MEASUREMENT /end GROUP
/begin GROUP S77__Override_Probe "Ecotron/Input/By-wire/Robeff EPAS ECU/Robeff EPAS FbMsg3/ Override Probe"
 /begin REF_CHARACTERISTIC EPAS_DriverIntervention_overrideOvrCal_val EPAS_DriverIntervention_overrideOvrEn_val /end REF_CHARACTERISTIC
 /begin REF_MEASUREMENT EPAS_DriverIntervention_overrideOvrMsr /end REF_MEASUREMENT
/end GROUP
/begin GROUP S241_Acceleration1 "Ecotron/Main /LongControl /ACC Control/Fcalculator /Acceleration1" /begin REF_MEASUREMENT debug_filtered_ACC /end REF_MEASUREMENT /end GROUP
/begin GROUP S241_Subsystem "Ecotron/Main /LongControl /ACC Control/Fcalculator /Subsystem" /begin REF_CHARACTERISTIC Torque_PID_D Torque_PID_I Torque_PID_P /end REF_CHARACTERISTIC /end GROUP
/begin GROUP S241_Subsystem1 "Ecotron/Main /LongControl /ACC Control/Fcalculator /Subsystem1" /begin REF_CHARACTERISTIC Brake_PID_D Brake_PID_I Brake_PID_P /end REF_CHARACTERISTIC /end GROUP
/begin GROUP S273_Enabled "Ecotron/Main /LongControl /ACC Control/Fcalculator /Discrete PID Controller/Saturation/Enabled" /begin REF_MEASUREMENT debug_CompensationPID_out /end REF_MEASUREMENT /end GROUP
/end MODULE
/end PROJECT
/* (add any file trailer comments here) */
/* EOF Ecotron.a2l */
